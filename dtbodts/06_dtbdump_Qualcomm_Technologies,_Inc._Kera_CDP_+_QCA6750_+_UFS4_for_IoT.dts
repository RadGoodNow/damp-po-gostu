/dts-v1/;

/ {
	model = "Qualcomm Technologies, Inc. Kera CDP + QCA6750 + UFS4 for IoT";
	compatible = "qcom,kera-cdp", "qcom,kera", "qcom,kerap-cdp", "qcom,kerap", "qcom,cdp";
	qcom,msm-id = <0x2ae 0x10000 0x293 0x10000>;
	qcom,board-id = <0x50001 0x00>;

	fragment@0 {
		target = <0xffffffff>;

		__overlay__ {
			vdd-supply = <0xffffffff>;
			qcom,vdd-voltage-level = <0x2d2a80 0x2d2a80>;
			qcom,vdd-current-level = <0x00 0xee58e>;
			vdd-io-supply = <0xffffffff>;
			qcom,vdd-io-voltage-level = <0x1b7740 0x2d2a80>;
			qcom,vdd-io-current-level = <0x00 0x16c6>;
			pinctrl-names = "default", "sleep";
			pinctrl-0 = <0xffffffff>;
			pinctrl-1 = <0xffffffff>;
			cd-gpios = <0xffffffff 0x3a 0x01>;
			qcom,uses_level_shifter;
			status = "ok";
		};
	};

	fragment@1 {
		target = <0xffffffff>;

		__overlay__ {
			#address-cells = <0x01>;
			#size-cells = <0x00>;
			status = "ok";
			qcom,touch-active = "goodix,gt9916S";
			qcom,la-vm;

			goodix-berlin@0 {
				compatible = "goodix,gt9916S";
				reg = <0x00>;
				spi-max-frequency = <0xf4240>;
				interrupt-parent = <0xffffffff>;
				interrupts = <0x0d 0x2008>;
				goodix,reset-gpio = <0xffffffff 0x10 0x00>;
				goodix,irq-gpio = <0xffffffff 0x0d 0x2008>;
				goodix,irq-flags = <0x02>;
				goodix,panel-max-x = <0x438>;
				goodix,panel-max-y = <0x960>;
				goodix,panel-max-w = <0xff>;
				goodix,panel-max-p = <0x1000>;
				goodix,firmware-name = "goodix_firmware_spi.bin";
				goodix,config-name = "goodix_cfg_group_spi.bin";
				goodix,avdd-name = "avdd";
				goodix,iovdd-name = "iovdd";
				avdd-supply = <0xffffffff>;
				iovdd-supply = <0xffffffff>;
				goodix,touch-type = "primary";
				goodix,qts_en;
				qts,trusted-touch-mode = "vm_mode";
				qts,touch-environment = "pvm";
				qts,trusted-touch-type = "primary";
				qts,trusted-touch-spi-irq = <0x28d>;
				qts,trusted-touch-io-bases = <0x880000>;
				qts,trusted-touch-io-sizes = <0x1000>;
				qts,trusted-touch-vm-gpio-list = <0xffffffff 0x00 0x00 0xffffffff 0x01 0x00 0xffffffff 0x02 0x00 0xffffffff 0x03 0x00 0xffffffff 0x10 0x00 0xffffffff 0x0d 0x2008>;
			};
		};
	};

	fragment@2 {
		target = <0xffffffff>;

		__overlay__ {
			status = "disabled";
		};
	};

	fragment@3 {
		target = <0xffffffff>;

		__overlay__ {
			status = "disabled";
		};
	};

	fragment@4 {
		target = <0xffffffff>;

		__overlay__ {
			status = "disabled";
		};
	};

	fragment@5 {
		target = <0xffffffff>;

		__overlay__ {
			compatible = "qcom,ufs-phy-qmp-v4-niobe";
			vdda-phy-supply = <0xffffffff>;
			vdda-phy-max-microamp = <0x33b94>;
			vdda-phy-min-microvolt = <0xdea80>;
			vdda-pll-supply = <0xffffffff>;
			vdda-pll-max-microamp = <0x479a>;
			vdd-phy-gdsc-supply = <0xffffffff>;
			vdda-qref-supply = <0xffffffff>;
			vdda-qref-max-microamp = <0x762>;
			status = "ok";
		};
	};

	fragment@6 {
		target = <0xffffffff>;

		__overlay__ {
			vdd-hba-supply = <0xffffffff>;
			vcc-supply = <0xffffffff>;
			vcc-max-microamp = <0x124f80>;
			vccq-supply = <0xffffffff>;
			vccq-max-microamp = <0x124f80>;
			qcom,vddp-ref-clk-supply = <0xffffffff>;
			qcom,vddp-ref-clk-max-microamp = <0x64>;
			qcom,vccq-parent-supply = <0xffffffff>;
			qcom,vccq-parent-max-microamp = <0x33450>;
			status = "ok";
		};
	};

	fragment@7 {
		target = <0xffffffff>;

		__overlay__ {
			#address-cells = <0x02>;
			#size-cells = <0x00>;
			interrupt-controller;
			#interrupt-cells = <0x04>;

			qcom,pmiv0108@7 {
				compatible = "qcom,spmi-pmic";
				reg = <0x07 0x00>;
				#address-cells = <0x01>;
				#size-cells = <0x00>;
				phandle = <0x0a>;

				qcom,temp-alarm@a00 {
					compatible = "qcom,spmi-temp-alarm";
					reg = <0xa00>;
					interrupts = <0x07 0x0a 0x00 0x03>;
					#thermal-sensor-cells = <0x00>;
					io-channels = <0xffffffff 0x703>;
					io-channel-names = "thermal";
					phandle = <0x01>;
				};

				pinctrl@8800 {
					compatible = "qcom,pmiv0108-gpio";
					reg = <0x8800>;
					gpio-controller;
					#gpio-cells = <0x02>;
					interrupt-controller;
					#interrupt-cells = <0x02>;
					phandle = <0x0b>;

					charger_skin_therm {

						charger_skin_therm_default {
							pins = "gpio6";
							bias-high-impedence;
							phandle = <0x04>;
						};
					};
				};

				eusb2-repeater@fd00 {
					compatible = "qcom,pmic-eusb2-repeater";
					reg = <0xfd00>;
					vdd18-supply = <0xffffffff>;
					vdd3-supply = <0xffffffff>;
					status = "ok";
					phandle = <0x09>;
				};

				qcom,vibrator@df00 {
					compatible = "qcom,qpnp-vibrator-ldo";
					reg = <0xdf00>;
					qcom,vib-ldo-volt-uv = <0x2dc6c0>;
					qcom,disable-overdrive;
					phandle = <0x0c>;
				};

				qcom,amoled {
					compatible = "qcom,amoled-regulator";
					#address-cells = <0x01>;
					#size-cells = <0x00>;
					status = "ok";
					phandle = <0x0d>;

					oledb@fa00 {
						reg = <0xfa00>;
						reg-names = "oledb_base";
						regulator-name = "oledb";
						regulator-min-microvolt = <0x4c4b40>;
						regulator-max-microvolt = <0x7a1200>;
						qcom,swire-control;
						phandle = <0x0e>;
					};

					ab@f900 {
						reg = <0xf900>;
						reg-names = "ab_base";
						regulator-name = "ab";
						regulator-min-microvolt = <0x4630c0>;
						regulator-max-microvolt = <0x4f5880>;
						qcom,swire-control;
						phandle = <0x0f>;
					};

					ibb@f800 {
						reg = <0xf800>;
						reg-names = "ibb_base";
						regulator-name = "ibb";
						regulator-min-microvolt = <0x155cc0>;
						regulator-max-microvolt = <0x64b540>;
						qcom,swire-control;
						regulator-allow-set-load;
						phandle = <0x10>;
					};
				};

				qcom,amoled-ecm@f900 {
					compatible = "qcom,amoled-ecm";
					reg = <0xf900>;
					status = "disabled";
					nvmem-names = "amoled-ecm-sdam0", "amoled-ecm-sdam1", "amoled-ecm-sdam2";
					nvmem = <0xffffffff 0xffffffff 0xffffffff>;
					interrupt-names = "ecm-sdam0", "ecm-sdam1", "ecm-sdam2";
					interrupts = <0x07 0x7c 0x01 0x01 0x07 0x7d 0x01 0x01 0x07 0x98 0x01 0x01>;
					phandle = <0x11>;
				};

				bcl@4700 {
					compatible = "qcom,pmiv010x-bcl-v5";
					reg = <0x4700 0x100>;
					interrupts = <0x07 0x47 0x00 0x00 0x07 0x47 0x01 0x00 0x07 0x47 0x02 0x00>;
					interrupt-names = "bcl-lvl0", "bcl-lvl1", "bcl-lvl2";
					qcom,pmic7-threshold;
					#thermal-sensor-cells = <0x01>;
					phandle = <0x02>;
				};

				bcl-soc {
					compatible = "qcom,msm-bcl-soc";
					#thermal-sensor-cells = <0x00>;
					phandle = <0x03>;
				};
			};
		};
	};

	fragment@8 {
		target = <0xffffffff>;

		__overlay__ {

			pmiv010x_tz {
				polling-delay-passive = <0x64>;
				polling-delay = <0x00>;
				thermal-governor = "step_wise";
				thermal-sensors = <0x01>;
				phandle = <0x12>;

				trips {

					trip0 {
						temperature = <0x17318>;
						hysteresis = <0x00>;
						type = "passive";
						phandle = <0x13>;
					};

					trip1 {
						temperature = <0x1c138>;
						hysteresis = <0x00>;
						type = "passive";
						phandle = <0x14>;
					};

					trip2 {
						temperature = <0x23668>;
						hysteresis = <0x00>;
						type = "critical";
						phandle = <0x15>;
					};
				};
			};

			pmiv010x-ibat-lvl0 {
				polling-delay-passive = <0x00>;
				polling-delay = <0x00>;
				thermal-sensors = <0x02 0x00>;

				trips {

					ibat-lvl0 {
						temperature = <0x1b58>;
						hysteresis = <0xc8>;
						type = "passive";
						phandle = <0x16>;
					};
				};
			};

			pmiv010x-ibat-lvl1 {
				polling-delay-passive = <0x00>;
				polling-delay = <0x00>;
				thermal-sensors = <0x02 0x01>;

				trips {

					ibat-lvl1 {
						temperature = <0x2328>;
						hysteresis = <0xc8>;
						type = "passive";
						phandle = <0x17>;
					};
				};
			};

			pmiv010x-bcl-lvl0 {
				polling-delay-passive = <0x64>;
				polling-delay = <0x00>;
				thermal-sensors = <0x02 0x05>;

				trips {

					thermal-engine-trip {
						temperature = <0x64>;
						hysteresis = <0x00>;
						type = "passive";
					};

					thermal-hal-trip {
						temperature = <0x64>;
						hysteresis = <0x00>;
						type = "passive";
					};

					b-bcl-lvl0 {
						temperature = <0x01>;
						hysteresis = <0x01>;
						type = "passive";
						phandle = <0x05>;
					};
				};
			};

			pmiv010x-bcl-lvl1 {
				polling-delay-passive = <0x64>;
				polling-delay = <0x00>;
				thermal-sensors = <0x02 0x06>;

				trips {

					thermal-engine-trip {
						temperature = <0x64>;
						hysteresis = <0x00>;
						type = "passive";
					};

					thermal-hal-trip {
						temperature = <0x64>;
						hysteresis = <0x00>;
						type = "passive";
					};

					b-bcl-lvl1 {
						temperature = <0x01>;
						hysteresis = <0x01>;
						type = "passive";
						phandle = <0x06>;
					};
				};
			};

			pmiv010x-bcl-lvl2 {
				polling-delay-passive = <0x64>;
				polling-delay = <0x00>;
				thermal-sensors = <0x02 0x07>;

				trips {

					thermal-engine-trip {
						temperature = <0x64>;
						hysteresis = <0x00>;
						type = "passive";
					};

					thermal-hal-trip {
						temperature = <0x64>;
						hysteresis = <0x00>;
						type = "passive";
					};

					b-bcl-lvl2 {
						temperature = <0x01>;
						hysteresis = <0x01>;
						type = "passive";
						phandle = <0x07>;
					};
				};
			};

			socd {
				polling-delay-passive = <0x64>;
				polling-delay = <0x00>;
				thermal-sensors = <0x03>;

				trips {

					thermal-engine-trip {
						temperature = <0x64>;
						hysteresis = <0x00>;
						type = "passive";
					};

					thermal-hal-trip {
						temperature = <0x64>;
						hysteresis = <0x00>;
						type = "passive";
					};

					socd-trip {
						temperature = <0x5a>;
						hysteresis = <0x00>;
						type = "passive";
						phandle = <0x08>;
					};
				};
			};

			vbat {
				polling-delay-passive = <0x00>;
				polling-delay = <0x00>;
				thermal-sensors = <0x02 0x02>;

				trips {

					vbat-lvl0 {
						temperature = <0xaf0>;
						hysteresis = <0x64>;
						type = "passive";
						phandle = <0x18>;
					};

					vbat-lvl1 {
						temperature = <0xa28>;
						hysteresis = <0x64>;
						type = "passive";
						phandle = <0x19>;
					};

					vbat-lvl2 {
						temperature = <0x8fc>;
						hysteresis = <0x64>;
						type = "passive";
						phandle = <0x1a>;
					};
				};
			};
		};
	};

	fragment@9 {
		target = <0xffffffff>;

		__overlay__ {
			#cooling-cells = <0x02>;
			qcom,thermal-mitigation-step = <0x7a120>;
		};
	};

	fragment@10 {
		target = <0xffffffff>;

		__overlay__ {
			pinctrl-names = "default";
			pinctrl-0 = <0x04 0xffffffff>;

			pmiv010x_ref_gnd {
				reg = <0x700>;
				label = "pmiv010x_ref_gnd";
				qcom,pre-scaling = <0x01 0x01>;
			};

			pmiv010x_vref_1p25 {
				reg = <0x701>;
				label = "pmiv010x_vref_1p25";
				qcom,pre-scaling = <0x01 0x01>;
			};

			pmiv010x_die_temp {
				reg = <0x703>;
				label = "pmiv010x_die_temp";
				qcom,pre-scaling = <0x01 0x01>;
			};

			pmiv010x_vph_pwr {
				reg = <0x78e>;
				label = "pmiv010x_vph_pwr";
				qcom,pre-scaling = <0x01 0x03>;
			};

			pmiv010x_vbat_sns_qbg {
				reg = <0x78f>;
				label = "pmiv010x_vbat_sns";
				qcom,pre-scaling = <0x01 0x03>;
			};

			pmiv010x_chg_temp {
				reg = <0x710>;
				label = "pmiv010x_chg_temp";
				qcom,pre-scaling = <0x01 0x01>;
			};

			pmiv010x_bat_therm {
				reg = <0x744>;
				label = "pmiv010x_bat_therm";
				qcom,ratiometric;
				qcom,hw-settle-time = <0xc8>;
				qcom,pre-scaling = <0x01 0x01>;
				qcom,scale-fn-type = <0x17>;
			};

			pmiv010x_bat_id {
				reg = <0x745>;
				label = "pmiv010x_bat_id";
				qcom,ratiometric;
				qcom,hw-settle-time = <0xc8>;
				qcom,pre-scaling = <0x01 0x01>;
				qcom,scale-fn-type = <0x18>;
			};

			pmiv010x_iin_fb {
				reg = <0x717>;
				label = "pmiv010x_iin_fb";
			};

			pmiv010x_ichg_fb {
				reg = <0x7a1>;
				label = "pmiv010x_ichg_fb";
			};

			pmiv010x_sys_therm_7 {
				reg = <0x749>;
				label = "pmiv010x_charger_skin_therm";
				qcom,ratiometric;
				qcom,hw-settle-time = <0xc8>;
				qcom,pre-scaling = <0x01 0x01>;
				qcom,adc-tm-type = <0x01>;
			};

			pmiv010x_sys_therm_8 {
				reg = <0x747>;
				label = "pmiv010x_conn_therm";
				qcom,ratiometric;
				qcom,hw-settle-time = <0xc8>;
				qcom,pre-scaling = <0x01 0x01>;
				qcom,adc-tm-type = <0x01>;
			};
		};
	};

	fragment@11 {
		target = <0xffffffff>;

		__overlay__ {

			spmi@0 {
				reg = <0x00>;
				#address-cells = <0x02>;
				#size-cells = <0x00>;

				qcom,pmiv010x-debug@7 {
					compatible = "qcom,spmi-pmic";
					reg = <0x07 0x00>;
					qcom,can-sleep;
				};
			};
		};
	};

	fragment@12 {
		target = <0xffffffff>;

		__overlay__ {

			qcom,pmiv010x-debug@7 {
				compatible = "qcom,spmi-pmic";
				reg = <0x07 0x00>;
				#address-cells = <0x02>;
				#size-cells = <0x00>;
				qcom,can-sleep;
			};
		};
	};

	fragment@13 {
		target = <0xffffffff>;

		__overlay__ {

			pmiv010x-ibat-lvl0 {

				trips {

					ibat-lvl0 {
						temperature = <0x2710>;
					};
				};
			};

			pmiv010x-ibat-lvl1 {

				trips {

					ibat-lvl1 {
						temperature = <0x2cec>;
					};
				};
			};

			sys-therm-7 {
				polling-delay-passive = <0x00>;
				polling-delay = <0x00>;
				thermal-sensors = <0xffffffff 0x749>;

				trips {

					active-config0 {
						temperature = <0x1e848>;
						hysteresis = <0x3e8>;
						type = "passive";
					};

					active-config1 {
						temperature = <0x1e848>;
						hysteresis = <0x3e8>;
						type = "passive";
					};
				};
			};

			sys-therm-8 {
				polling-delay-passive = <0x00>;
				polling-delay = <0x00>;
				thermal-sensors = <0xffffffff 0x747>;

				trips {

					active-config0 {
						temperature = <0x1e848>;
						hysteresis = <0x3e8>;
						type = "passive";
					};

					active-config1 {
						temperature = <0x1e848>;
						hysteresis = <0x3e8>;
						type = "passive";
					};
				};
			};

			pmiv010x-bcl-lvl0 {

				cooling-maps {

					lbat_0_nr_scg {
						trip = <0x05>;
						cooling-device = <0xffffffff 0x03 0x03>;
					};

					lbat_0_nr {
						trip = <0x05>;
						cooling-device = <0xffffffff 0x06 0x06>;
					};

					lbat_0_mdm_lte {
						trip = <0x05>;
						cooling-device = <0xffffffff 0x08 0x08>;
					};

					lbat_1_gpu {
						trip = <0x05>;
						cooling-device = <0xffffffff 0x02 0x02>;
					};
				};
			};

			pmiv010x-bcl-lvl1 {

				cooling-maps {

					lbat_1_nr_scg {
						trip = <0x06>;
						cooling-device = <0xffffffff 0x0a 0x0a>;
					};

					lbat_1_nr {
						trip = <0x06>;
						cooling-device = <0xffffffff 0x09 0x09>;
					};

					lbat_1_mdm_lte {
						trip = <0x06>;
						cooling-device = <0xffffffff 0x0a 0x0a>;
					};

					lbat_1_gpu {
						trip = <0x06>;
						cooling-device = <0xffffffff 0x03 0x03>;
					};
				};
			};

			pmiv010x-bcl-lvl2 {

				cooling-maps {

					lbat_2_gpu {
						trip = <0x07>;
						cooling-device = <0xffffffff 0x07 0x07>;
					};
				};
			};

			socd {

				cooling-maps {

					socd_apc1 {
						trip = <0x08>;
						cooling-device = <0xffffffff 0x01 0x01>;
					};

					socd_cdsp1 {
						trip = <0x08>;
						cooling-device = <0xffffffff 0x04 0x04>;
					};

					socd_gpu0 {
						trip = <0x08>;
						cooling-device = <0xffffffff 0x04 0x04>;
					};
				};
			};
		};
	};

	fragment@14 {
		target = <0xffffffff>;

		__overlay__ {
			dummy-supply = <0x09>;
			usb-repeater = <0x09>;
		};
	};

	fragment@15 {
		target = <0xffffffff>;

		__overlay__ {
			dummy-supply = <0x09>;
			usb-repeater = <0x09>;
		};
	};

	fragment@16 {
		target = <0xffffffff>;

		__overlay__ {
			status = "ok";
		};
	};

	__symbols__ {
		icnss_cdev_wpss = "/fragment@35/__overlay__/qcom,wcn6750/qcom,icnss_cdev2";
		icnss_cdev_apss = "/fragment@35/__overlay__/qcom,wcn6750/qcom,icnss_cdev1";
		icnss2 = "/fragment@35/__overlay__/qcom,wcn6750";
		smp2p_wlan_3_out = "/fragment@35/__overlay__/qcom,smp2p-wpss/qcom,smp2p-wlan-3-out";
		smp2p_wlan_2_out = "/fragment@35/__overlay__/qcom,smp2p-wpss/qcom,smp2p-wlan-2-out";
		smp2p_wlan_2_in = "/fragment@35/__overlay__/qcom,smp2p-wpss/qcom,smp2p-wlan-2-in";
		smp2p_wlan_1_out = "/fragment@35/__overlay__/qcom,smp2p-wpss/qcom,smp2p-wlan-1-out";
		smp2p_wlan_1_in = "/fragment@35/__overlay__/qcom,smp2p-wpss/qcom,smp2p-wlan-1-in";
		icnss_sw_ctrl = "/fragment@34/__overlay__/icnss_sw_ctrl";
		slimbus = "/fragment@31/__overlay__/ngd@1/btfmslim-driver";
		bluetooth = "/fragment@30/__overlay__/bt_wcn6750";
		cnss_bt_sw_ctrl = "/fragment@29/__overlay__/cnss_wlan_sw_ctrl";
		bt_en = "/fragment@28/__overlay__/bt_en";
		clock_audio_bt_swr_mclk_clk_2x = "/fragment@25/__overlay__/bt_swr_mclk_clk_2x";
		clock_audio_bt_swr_mclk_clk = "/fragment@25/__overlay__/bt_swr_mclk_clk";
		clock_audio_rx_mclk2_2x_clk = "/fragment@25/__overlay__/rx_mclk2_2x_clk";
		clock_audio_wsa_tx = "/fragment@25/__overlay__/wsa_core_tx_clk";
		clock_audio_tx_1 = "/fragment@25/__overlay__/tx_core_clk";
		clock_audio_rx_tx = "/fragment@25/__overlay__/rx_core_tx_clk";
		clock_audio_rx_1 = "/fragment@25/__overlay__/rx_core_clk";
		clock_audio_wsa_1 = "/fragment@25/__overlay__/wsa_core_clk";
		clock_audio_va_1 = "/fragment@25/__overlay__/va_core_clk";
		wcd_rst_gpio = "/fragment@25/__overlay__/msm_cdc_pinctrl@32";
		wsa_spkr_en13 = "/fragment@25/__overlay__/wsa_spkr_en2_pinctrl";
		wsa_spkr_en02 = "/fragment@25/__overlay__/wsa_spkr_en1_pinctrl";
		bt_swr_gpios = "/fragment@24/__overlay__/bt_swr_clk_data_pinctrl";
		cdc_dmic67_gpios = "/fragment@24/__overlay__/cdc_dmic67_pinctrl";
		cdc_dmic45_gpios = "/fragment@24/__overlay__/cdc_dmic45_pinctrl";
		cdc_dmic23_gpios = "/fragment@24/__overlay__/cdc_dmic23_pinctrl";
		cdc_dmic01_gpios = "/fragment@24/__overlay__/cdc_dmic01_pinctrl";
		va_swr_gpios = "/fragment@24/__overlay__/tx_swr_clk_data_pinctrl";
		rx_swr_gpios = "/fragment@24/__overlay__/rx_swr_clk_data_pinctrl";
		wsa_swr_gpios = "/fragment@24/__overlay__/wsa_swr_clk_data_pinctrl";
		cdc_sep_mi2s_gpios = "/fragment@24/__overlay__/sep_mi2s_pinctrl";
		cdc_sen_mi2s_gpios = "/fragment@24/__overlay__/sen_mi2s_pinctrl";
		cdc_quin_mi2s_gpios = "/fragment@24/__overlay__/quin_mi2s_pinctrl";
		cdc_quat_mi2s_gpios = "/fragment@24/__overlay__/quat_mi2s_pinctrl";
		cdc_pri_mi2s_gpios = "/fragment@24/__overlay__/pri_mi2s_pinctrl";
		kera_snd = "/fragment@24/__overlay__/sound";
		wcd9378_codec = "/fragment@21/__overlay__/wcd9378-codec";
		wcd_mb4_reg = "/fragment@21/__overlay__/wcd939x-codec/qcom,wcd-mb4-reg";
		wcd_mb3_reg = "/fragment@21/__overlay__/wcd939x-codec/qcom,wcd-mb3-reg";
		wcd_mb2_reg = "/fragment@21/__overlay__/wcd939x-codec/qcom,wcd-mb2-reg";
		wcd_mb1_reg = "/fragment@21/__overlay__/wcd939x-codec/qcom,wcd-mb1-reg";
		wcd939x_codec = "/fragment@21/__overlay__/wcd939x-codec";
		wsa884x_0221 = "/fragment@21/__overlay__/wsa-macro@6B00000/wsa_swr_master/wsa884x@02170221";
		wsa884x_0220 = "/fragment@21/__overlay__/wsa-macro@6B00000/wsa_swr_master/wsa884x@02170220";
		swr0 = "/fragment@21/__overlay__/wsa-macro@6B00000/wsa_swr_master";
		wsa_macro = "/fragment@21/__overlay__/wsa-macro@6B00000";
		wcd939x_rx_slave = "/fragment@21/__overlay__/rx-macro@6AC0000/rx_swr_master/wcd939x-rx-slave";
		wcd9378_rx_slave = "/fragment@21/__overlay__/rx-macro@6AC0000/rx_swr_master/wcd9378-rx-slave";
		swr_haptics = "/fragment@21/__overlay__/rx-macro@6AC0000/rx_swr_master/swr_haptics@f0170220";
		swr1 = "/fragment@21/__overlay__/rx-macro@6AC0000/rx_swr_master";
		rx_macro = "/fragment@21/__overlay__/rx-macro@6AC0000";
		tx_macro = "/fragment@21/__overlay__/tx-macro@6AE0000";
		wcd939x_tx_slave = "/fragment@21/__overlay__/va-macro@7660000/va_swr_master/wcd939x-tx-slave";
		wcd9378_tx_slave = "/fragment@21/__overlay__/va-macro@7660000/va_swr_master/wcd9378-tx-slave";
		swr2 = "/fragment@21/__overlay__/va-macro@7660000/va_swr_master";
		va_macro = "/fragment@21/__overlay__/va-macro@7660000";
		wsa_swr_data_sleep = "/fragment@20/__overlay__/wsa_swr_data_pin/wsa_swr_data_sleep";
		wsa_swr_data_active = "/fragment@20/__overlay__/wsa_swr_data_pin/wsa_swr_data_active";
		wsa_swr_clk_active = "/fragment@20/__overlay__/wsa_swr_clk_pin/wsa_swr_clk_active";
		wsa_swr_clk_sleep = "/fragment@20/__overlay__/wsa_swr_clk_pin/wsa_swr_clk_sleep";
		cdc_dmic67_data_sleep = "/fragment@20/__overlay__/cdc_dmic67_data_sleep";
		cdc_dmic67_data_active = "/fragment@20/__overlay__/cdc_dmic67_data_active";
		cdc_dmic67_clk_sleep = "/fragment@20/__overlay__/lpi_dmic67_clk_sleep";
		cdc_dmic67_clk_active = "/fragment@20/__overlay__/cdc_dmic67_clk_active";
		cdc_dmic45_data_sleep = "/fragment@20/__overlay__/cdc_dmic45_data_sleep";
		cdc_dmic45_data_active = "/fragment@20/__overlay__/cdc_dmic45_data_active";
		cdc_dmic45_clk_sleep = "/fragment@20/__overlay__/lpi_dmic45_clk_sleep";
		cdc_dmic45_clk_active = "/fragment@20/__overlay__/cdc_dmic45_clk_active";
		cdc_dmic23_data_sleep = "/fragment@20/__overlay__/dmic23_data_sleep";
		cdc_dmic23_data_active = "/fragment@20/__overlay__/dmic23_data_active";
		cdc_dmic23_clk_sleep = "/fragment@20/__overlay__/dmic23_clk_sleep";
		cdc_dmic23_clk_active = "/fragment@20/__overlay__/dmic23_clk_active";
		cdc_dmic01_data_sleep = "/fragment@20/__overlay__/dmic01_data_sleep";
		cdc_dmic01_data_active = "/fragment@20/__overlay__/dmic01_data_active";
		cdc_dmic01_clk_sleep = "/fragment@20/__overlay__/dmic01_clk_sleep";
		cdc_dmic01_clk_active = "/fragment@20/__overlay__/dmic01_clk_active";
		rx_swr_data1_sleep = "/fragment@20/__overlay__/rx_swr_data1_sleep";
		rx_swr_data1_active = "/fragment@20/__overlay__/rx_swr_data1_active";
		rx_swr_data_sleep = "/fragment@20/__overlay__/rx_swr_data_sleep";
		rx_swr_data_active = "/fragment@20/__overlay__/rx_swr_data_active";
		rx_swr_clk_sleep = "/fragment@20/__overlay__/rx_swr_clk_sleep";
		rx_swr_clk_active = "/fragment@20/__overlay__/rx_swr_clk_active";
		tx_swr_data2_sleep = "/fragment@20/__overlay__/tx_swr_data2_sleep";
		tx_swr_data2_active = "/fragment@20/__overlay__/tx_swr_data2_active";
		tx_swr_data1_sleep = "/fragment@20/__overlay__/tx_swr_data1_sleep";
		tx_swr_data1_active = "/fragment@20/__overlay__/tx_swr_data1_active";
		tx_swr_data0_sleep = "/fragment@20/__overlay__/tx_swr_data0_sleep";
		tx_swr_data0_active = "/fragment@20/__overlay__/tx_swr_data0_active";
		tx_swr_clk_sleep = "/fragment@20/__overlay__/tx_swr_clk_sleep";
		tx_swr_clk_active = "/fragment@20/__overlay__/tx_swr_clk_active";
		bt_swr_data_active = "/fragment@20/__overlay__/bt_swr_data_pin/bt_swr_data_active";
		bt_swr_data_sleep = "/fragment@20/__overlay__/bt_swr_data_pin/bt_swr_data_sleep";
		bt_swr_clk_active = "/fragment@20/__overlay__/bt_swr_clk_pin/bt_swr_clk_active";
		bt_swr_clk_sleep = "/fragment@20/__overlay__/bt_swr_clk_pin/bt_swr_clk_sleep";
		lpi_aux3_sd1_active = "/fragment@20/__overlay__/lpi_aux3_sd1/lpi_aux3_sd1_active";
		lpi_aux3_sd1_sleep = "/fragment@20/__overlay__/lpi_aux3_sd1/lpi_aux3_sd1_sleep";
		lpi_aux3_sd0_active = "/fragment@20/__overlay__/lpi_aux3_sd0/lpi_aux3_sd0_active";
		lpi_aux3_sd0_sleep = "/fragment@20/__overlay__/lpi_aux3_sd0/lpi_aux3_sd0_sleep";
		lpi_aux3_ws_active = "/fragment@20/__overlay__/lpi_aux3_ws/lpi_aux3_ws_active";
		lpi_aux3_ws_sleep = "/fragment@20/__overlay__/lpi_aux3_ws/lpi_aux3_ws_sleep";
		lpi_aux3_sck_active = "/fragment@20/__overlay__/lpi_aux3_sck/lpi_aux3_sck_active";
		lpi_aux3_sck_sleep = "/fragment@20/__overlay__/lpi_aux3_sck/lpi_aux3_sck_sleep";
		lpi_aux2_sd1_active = "/fragment@20/__overlay__/lpi_aux2_sd1/lpi_aux2_sd1_active";
		lpi_aux2_sd1_sleep = "/fragment@20/__overlay__/lpi_aux2_sd1/lpi_aux2_sd1_sleep";
		lpi_aux2_sd0_active = "/fragment@20/__overlay__/lpi_aux2_sd0/lpi_aux2_sd0_active";
		lpi_aux2_sd0_sleep = "/fragment@20/__overlay__/lpi_aux2_sd0/lpi_aux2_sd0_sleep";
		lpi_aux2_ws_active = "/fragment@20/__overlay__/lpi_aux2_ws/lpi_aux2_ws_active";
		lpi_aux2_ws_sleep = "/fragment@20/__overlay__/lpi_aux2_ws/lpi_aux2_ws_sleep";
		lpi_aux2_sck_active = "/fragment@20/__overlay__/lpi_aux2_sck/lpi_aux2_sck_active";
		lpi_aux2_sck_sleep = "/fragment@20/__overlay__/lpi_aux2_sck/lpi_aux2_sck_sleep";
		lpi_aux1_sd1_active = "/fragment@20/__overlay__/lpi_aux1_sd1/lpi_aux1_sd1_active";
		lpi_aux1_sd1_sleep = "/fragment@20/__overlay__/lpi_aux1_sd1/lpi_aux1_sd1_sleep";
		lpi_aux1_sd0_active = "/fragment@20/__overlay__/lpi_aux1_sd0/lpi_aux1_sd0_active";
		lpi_aux1_sd0_sleep = "/fragment@20/__overlay__/lpi_aux1_sd0/lpi_aux1_sd0_sleep";
		lpi_aux1_ws_active = "/fragment@20/__overlay__/lpi_aux1_ws/lpi_aux1_ws_active";
		lpi_aux1_ws_sleep = "/fragment@20/__overlay__/lpi_aux1_ws/lpi_aux1_ws_sleep";
		lpi_aux1_sck_active = "/fragment@20/__overlay__/lpi_aux1_sck/lpi_aux1_sck_active";
		lpi_aux1_sck_sleep = "/fragment@20/__overlay__/lpi_aux1_sck/lpi_aux1_sck_sleep";
		quat_aux_sd3_active = "/fragment@20/__overlay__/quat_aux_sd3/quat_aux_sd3_active";
		quat_aux_sd3_sleep = "/fragment@20/__overlay__/quat_aux_sd3/quat_aux_sd3_sleep";
		quat_aux_sd2_active = "/fragment@20/__overlay__/quat_aux_sd2/quat_aux_sd2_active";
		quat_aux_sd2_sleep = "/fragment@20/__overlay__/quat_aux_sd2/quat_aux_sd2_sleep";
		quat_aux_sd1_active = "/fragment@20/__overlay__/quat_aux_sd1/quat_aux_sd1_active";
		quat_aux_sd1_sleep = "/fragment@20/__overlay__/quat_aux_sd1/quat_aux_sd1_sleep";
		quat_aux_sd0_active = "/fragment@20/__overlay__/quat_aux_sd0/quat_aux_sd0_active";
		quat_aux_sd0_sleep = "/fragment@20/__overlay__/quat_aux_sd0/quat_aux_sd0_sleep";
		quat_aux_ws_active = "/fragment@20/__overlay__/quat_aux_ws/quat_aux_ws_active";
		quat_aux_ws_sleep = "/fragment@20/__overlay__/quat_aux_ws/quat_aux_ws_sleep";
		quat_aux_sck_active = "/fragment@20/__overlay__/quat_aux_sck/quat_aux_sck_active";
		quat_aux_sck_sleep = "/fragment@20/__overlay__/quat_aux_sck/quat_aux_sck_sleep";
		lpi_tdm3_sd1_active = "/fragment@20/__overlay__/lpi_tdm3_sd1/lpi_tdm3_sd1_active";
		lpi_tdm3_sd1_sleep = "/fragment@20/__overlay__/lpi_tdm3_sd1/lpi_tdm3_sd3_sleep";
		lpi_tdm3_sd0_active = "/fragment@20/__overlay__/lpi_tdm3_sd0/lpi_tdm3_sd0_active";
		lpi_tdm3_sd0_sleep = "/fragment@20/__overlay__/lpi_tdm3_sd0/lpi_tdm3_sd0_sleep";
		lpi_tdm3_ws_active = "/fragment@20/__overlay__/lpi_tdm3_ws/lpi_tdm3_ws_active";
		lpi_tdm3_ws_sleep = "/fragment@20/__overlay__/lpi_tdm3_ws/lpi_tdm3_ws_sleep";
		lpi_tdm3_sck_active = "/fragment@20/__overlay__/lpi_tdm3_sck/lpi_tdm3_sck_active";
		lpi_tdm3_sck_sleep = "/fragment@20/__overlay__/lpi_tdm3_sck/lpi_tdm3_sck_sleep";
		lpi_tdm2_sd1_active = "/fragment@20/__overlay__/lpi_tdm2_sd1/lpi_tdm2_sd1_active";
		lpi_tdm2_sd1_sleep = "/fragment@20/__overlay__/lpi_tdm2_sd1/lpi_tdm2_sd1_sleep";
		lpi_tdm2_sd0_active = "/fragment@20/__overlay__/lpi_tdm2_sd0/lpi_tdm2_sd0_active";
		lpi_tdm2_sd0_sleep = "/fragment@20/__overlay__/lpi_tdm2_sd0/lpi_tdm2_sd0_sleep";
		lpi_tdm2_ws_active = "/fragment@20/__overlay__/lpi_tdm2_ws/lpi_tdm2_ws_active";
		lpi_tdm2_ws_sleep = "/fragment@20/__overlay__/lpi_tdm2_ws/lpi_tdm2_ws_sleep";
		lpi_tdm2_sck_active = "/fragment@20/__overlay__/lpi_tdm2_sck/lpi_tdm2_sck_active";
		lpi_tdm2_sck_sleep = "/fragment@20/__overlay__/lpi_tdm2_sck/lpi_tdm2_sck_sleep";
		lpi_tdm1_sd1_active = "/fragment@20/__overlay__/lpi_tdm1_sd1/lpi_tdm1_sd1_active";
		lpi_tdm1_sd1_sleep = "/fragment@20/__overlay__/lpi_tdm1_sd1/lpi_tdm1_sd1_sleep";
		lpi_tdm1_sd0_active = "/fragment@20/__overlay__/lpi_tdm1_sd0/lpi_tdm1_sd0_active";
		lpi_tdm1_sd0_sleep = "/fragment@20/__overlay__/lpi_tdm1_sd0/lpi_tdm1_sd0_sleep";
		lpi_tdm1_ws_active = "/fragment@20/__overlay__/lpi_tdm1_ws/lpi_tdm1_ws_active";
		lpi_tdm1_ws_sleep = "/fragment@20/__overlay__/lpi_tdm1_ws/lpi_tdm1_ws_sleep";
		lpi_tdm1_sck_active = "/fragment@20/__overlay__/lpi_tdm1_sck/lpi_tdm1_sck_active";
		lpi_tdm1_sck_sleep = "/fragment@20/__overlay__/lpi_tdm1_sck/lpi_tdm1_sck_sleep";
		quat_tdm_sd3_active = "/fragment@20/__overlay__/quat_tdm_sd3/quat_tdm_sd3_active";
		quat_tdm_sd3_sleep = "/fragment@20/__overlay__/quat_tdm_sd3/quat_tdm_sd3_sleep";
		quat_tdm_sd2_active = "/fragment@20/__overlay__/quat_tdm_sd2/quat_tdm_sd2_active";
		quat_tdm_sd2_sleep = "/fragment@20/__overlay__/quat_tdm_sd2/quat_tdm_sd2_sleep";
		quat_tdm_sd1_active = "/fragment@20/__overlay__/quat_tdm_sd1/quat_tdm_sd1_active";
		quat_tdm_sd1_sleep = "/fragment@20/__overlay__/quat_tdm_sd1/quat_tdm_sd1_sleep";
		quat_tdm_sd0_active = "/fragment@20/__overlay__/quat_tdm_sd0/quat_tdm_sd0_active";
		quat_tdm_sd0_sleep = "/fragment@20/__overlay__/quat_tdm_sd0/quat_tdm_sd0_sleep";
		quat_tdm_ws_active = "/fragment@20/__overlay__/quat_tdm_ws/quat_tdm_ws_active";
		quat_tdm_ws_sleep = "/fragment@20/__overlay__/quat_tdm_ws/quat_tdm_ws_sleep";
		lpi_i2s3_data1_sleep = "/fragment@20/__overlay__/lpi_i2s3_sd1/lpi_i2s3_data1_sleep";
		lpi_i2s3_data1_active = "/fragment@20/__overlay__/lpi_i2s3_sd1/lpi_i2s3_data1_active";
		lpi_i2s3_data0_sleep = "/fragment@20/__overlay__/lpi_i2s3_sd0/lpi_i2s3_data0_sleep";
		lpi_i2s3_data0_active = "/fragment@20/__overlay__/lpi_i2s3_sd0/lpi_i2s3_data0_active";
		lpi_i2s3_ws_sleep = "/fragment@20/__overlay__/lpi_i2s3_ws/lpi_i2s3_ws_sleep";
		lpi_i2s3_ws_active = "/fragment@20/__overlay__/lpi_i2s3_ws/lpi_i2s3_ws_active";
		lpi_i2s3_sck_sleep = "/fragment@20/__overlay__/lpi_i2s3_sck/lpi_i2s3_sck_sleep";
		lpi_i2s3_sck_active = "/fragment@20/__overlay__/lpi_i2s3_sck/lpi_i2s3_sck_active";
		lpi_i2s2_data1_sleep = "/fragment@20/__overlay__/lpi_i2s2_sd1/lpi_i2s2_data1_sleep";
		lpi_i2s2_data1_active = "/fragment@20/__overlay__/lpi_i2s2_sd1/lpi_i2s2_data1_active";
		lpi_i2s2_data0_sleep = "/fragment@20/__overlay__/lpi_i2s2_sd0/lpi_i2s2_data0_sleep";
		lpi_i2s2_data0_active = "/fragment@20/__overlay__/lpi_i2s2_sd0/lpi_i2s2_data0_active";
		lpi_i2s2_ws_sleep = "/fragment@20/__overlay__/lpi_i2s2_ws/lpi_i2s2_ws_sleep";
		lpi_i2s2_ws_active = "/fragment@20/__overlay__/lpi_i2s2_ws/lpi_i2s2_ws_active";
		lpi_i2s2_sck_sleep = "/fragment@20/__overlay__/lpi_i2s2_sck/lpi_i2s2_sck_sleep";
		lpi_i2s2_sck_active = "/fragment@20/__overlay__/lpi_i2s2_sck/lpi_i2s2_sck_active";
		lpi_i2s1_data1_sleep = "/fragment@20/__overlay__/lpi_i2s1_sd1/lpi_i2s1_data1_sleep";
		lpi_i2s1_data1_active = "/fragment@20/__overlay__/lpi_i2s1_sd1/lpi_i2s1_data1_active";
		lpi_i2s1_data0_active = "/fragment@20/__overlay__/lpi_i2s1_sd0/lpi_i2s1_data0_active";
		lpi_i2s1_data0_sleep = "/fragment@20/__overlay__/lpi_i2s1_sd0/lpi_i2s1_data0_sleep";
		lpi_i2s1_ws_active = "/fragment@20/__overlay__/lpi_i2s1_ws/lpi_i2s1_ws_active";
		lpi_i2s1_ws_sleep = "/fragment@20/__overlay__/lpi_i2s1_ws/lpi_i2s1_ws_sleep";
		lpi_i2s1_sck_active = "/fragment@20/__overlay__/lpi_i2s1_sck/lpi_i2s1_sck_active";
		lpi_i2s1_sck_sleep = "/fragment@20/__overlay__/lpi_i2s1_sck/lpi_i2s1_sck_sleep";
		quat_mi2s_sd3_active = "/fragment@20/__overlay__/quat_mi2s_sd3/quat_mi2s_sd3_active";
		quat_mi2s_sd3_sleep = "/fragment@20/__overlay__/quat_mi2s_sd3/quat_mi2s_sd3_sleep";
		quat_mi2s_sd2_active = "/fragment@20/__overlay__/quat_mi2s_sd2/quat_mi2s_sd2_active";
		quat_mi2s_sd2_sleep = "/fragment@20/__overlay__/quat_mi2s_sd2/quat_mi2s_sd2_sleep";
		quat_mi2s_sd1_active = "/fragment@20/__overlay__/quat_mi2s_sd1/quat_mi2s_sd1_active";
		quat_mi2s_sd1_sleep = "/fragment@20/__overlay__/quat_mi2s_sd1/quat_mi2s_sd1_sleep";
		quat_mi2s_sd0_active = "/fragment@20/__overlay__/quat_mi2s_sd0/quat_mi2s_sd0_active";
		quat_mi2s_sd0_sleep = "/fragment@20/__overlay__/quat_mi2s_sd0/quat_mi2s_sd0_sleep";
		quat_mi2s_ws_active = "/fragment@20/__overlay__/quat_mi2s_ws/quat_mi2s_ws_active";
		quat_mi2s_ws_sleep = "/fragment@20/__overlay__/quat_mi2s_ws/quat_mi2s_ws_sleep";
		quat_mi2s_sck_active = "/fragment@20/__overlay__/quat_mi2s_sck/quat_mi2s_sck_active";
		quat_mi2s_sck_sleep = "/fragment@20/__overlay__/quat_mi2s_sck/quat_mi2s_sck_sleep";
		eeprom_front = "/fragment@19/__overlay__/qcom,eeprom4";
		eeprom_tele = "/fragment@19/__overlay__/qcom,eeprom3";
		actuator_triple_tele = "/fragment@19/__overlay__/qcom,actuator3";
		eeprom_uw = "/fragment@18/__overlay__/qcom,eeprom1";
		eeprom_wide = "/fragment@18/__overlay__/qcom,eeprom2";
		ois_wide = "/fragment@18/__overlay__/qcom,ois0";
		actuator_triple_uw = "/fragment@18/__overlay__/qcom,actuator1";
		actuator_triple_wide = "/fragment@18/__overlay__/qcom,actuator2";
		led_flash_triple_rear_ultrawide = "/fragment@17/__overlay__/qcom,camera-flash3";
		led_flash_triple_rear_tele = "/fragment@17/__overlay__/qcom,camera-flash2";
		led_flash_triple_rear_wide = "/fragment@17/__overlay__/qcom,camera-flash1";
		pmiv010x_7 = "/fragment@7/__overlay__/qcom,pmiv0108@7";
		pmiv010x_tz = "/fragment@7/__overlay__/qcom,pmiv0108@7/qcom,temp-alarm@a00";
		pmiv010x_gpios = "/fragment@7/__overlay__/qcom,pmiv0108@7/pinctrl@8800";
		charger_skin_therm_default = "/fragment@7/__overlay__/qcom,pmiv0108@7/pinctrl@8800/charger_skin_therm/charger_skin_therm_default";
		pmiv010x_eusb2_repeater = "/fragment@7/__overlay__/qcom,pmiv0108@7/eusb2-repeater@fd00";
		pmiv010x_vib = "/fragment@7/__overlay__/qcom,pmiv0108@7/qcom,vibrator@df00";
		pmiv010x_amoled = "/fragment@7/__overlay__/qcom,pmiv0108@7/qcom,amoled";
		oledb_vreg = "/fragment@7/__overlay__/qcom,pmiv0108@7/qcom,amoled/oledb@fa00";
		ab_vreg = "/fragment@7/__overlay__/qcom,pmiv0108@7/qcom,amoled/ab@f900";
		ibb_vreg = "/fragment@7/__overlay__/qcom,pmiv0108@7/qcom,amoled/ibb@f800";
		pmiv010x_amoled_ecm = "/fragment@7/__overlay__/qcom,pmiv0108@7/qcom,amoled-ecm@f900";
		pmiv010x_bcl = "/fragment@7/__overlay__/qcom,pmiv0108@7/bcl@4700";
		bcl_soc = "/fragment@7/__overlay__/qcom,pmiv0108@7/bcl-soc";
		pmiv010x_temp_alarm = "/fragment@8/__overlay__/pmiv010x_tz";
		pmiv010x_trip0 = "/fragment@8/__overlay__/pmiv010x_tz/trips/trip0";
		pmiv010x_trip1 = "/fragment@8/__overlay__/pmiv010x_tz/trips/trip1";
		pmiv010x_trip2 = "/fragment@8/__overlay__/pmiv010x_tz/trips/trip2";
		ibat_lvl0 = "/fragment@8/__overlay__/pmiv010x-ibat-lvl0/trips/ibat-lvl0";
		ibat_lvl1 = "/fragment@8/__overlay__/pmiv010x-ibat-lvl1/trips/ibat-lvl1";
		b_bcl_lvl0 = "/fragment@8/__overlay__/pmiv010x-bcl-lvl0/trips/b-bcl-lvl0";
		b_bcl_lvl1 = "/fragment@8/__overlay__/pmiv010x-bcl-lvl1/trips/b-bcl-lvl1";
		b_bcl_lvl2 = "/fragment@8/__overlay__/pmiv010x-bcl-lvl2/trips/b-bcl-lvl2";
		socd_trip = "/fragment@8/__overlay__/socd/trips/socd-trip";
		vbat_lvl0 = "/fragment@8/__overlay__/vbat/trips/vbat-lvl0";
		vbat_lvl1 = "/fragment@8/__overlay__/vbat/trips/vbat-lvl1";
		vbat_lvl2 = "/fragment@8/__overlay__/vbat/trips/vbat-lvl2";
	};

	__fixups__ {
		aoss_qmp = "/fragment@35/__overlay__/qcom,wcn6750:qcom,qmp:0";
		wlan_msa_mem = "/fragment@35/__overlay__/qcom,wcn6750:qcom,wlan-msa-fixed-region:0";
		apps_smmu = "/fragment@35/__overlay__/qcom,wcn6750:iommus:0";
		wpss_pas = "/fragment@35/__overlay__/qcom,wcn6750:qcom,rproc-handle:0";
		L18B = "/fragment@33/__overlay__/nq@64:vdd-supply:0";
		qupv3_se4_i2c = "/fragment@33:target:0";
		qupv3_se5_4uart = "/fragment@32:target:0";
		slim_msm = "/fragment@31:target:0";
		S4B = "/fragment@30/__overlay__/bt_wcn6750:qcom,bt-vdd-ipa-2p2-supply:0";
		S1B = "/fragment@30/__overlay__/bt_wcn6750:qcom,bt-vdd-rfa1-supply:0", "/fragment@35/__overlay__/qcom,wcn6750:vdd-1.8-xo-supply:0";
		S3B = "/fragment@30/__overlay__/bt_wcn6750:qcom,bt-vdd-aon-supply:0", "/fragment@30/__overlay__/bt_wcn6750:qcom,bt-vdd-dig-supply:0", "/fragment@30/__overlay__/bt_wcn6750:qcom,bt-vdd-rfacmn-supply:0", "/fragment@30/__overlay__/bt_wcn6750:qcom,bt-vdd-rfa-0p8-supply:0", "/fragment@35/__overlay__/qcom,wcn6750:vdd-cx-mx-supply:0";
		L11B = "/fragment@30/__overlay__/bt_wcn6750:qcom,bt-vdd-io-supply:0", "/fragment@35/__overlay__/qcom,wcn6750:vdd-1.8-io-supply:0";
		pm8550vs_g_gpios = "/fragment@28:target:0", "/fragment@30/__overlay__/bt_wcn6750:qcom,bt-reset-gpio:0";
		adsp_loader = "/fragment@26:target:0";
		wcd_reset_sleep = "/fragment@25/__overlay__/msm_cdc_pinctrl@32:pinctrl-1:0";
		wcd_reset_active = "/fragment@25/__overlay__/msm_cdc_pinctrl@32:pinctrl-0:0";
		spkr_2_sd_n_sleep = "/fragment@25/__overlay__/wsa_spkr_en2_pinctrl:pinctrl-1:0";
		spkr_2_sd_n_active = "/fragment@25/__overlay__/wsa_spkr_en2_pinctrl:pinctrl-0:0";
		spkr_1_sd_n_sleep = "/fragment@25/__overlay__/wsa_spkr_en1_pinctrl:pinctrl-1:0";
		spkr_1_sd_n_active = "/fragment@25/__overlay__/wsa_spkr_en1_pinctrl:pinctrl-0:0";
		i2s0_sd0_sleep = "/fragment@24/__overlay__/pri_mi2s_pinctrl:pinctrl-1:8";
		i2s0_ws_sleep = "/fragment@24/__overlay__/pri_mi2s_pinctrl:pinctrl-1:4";
		i2s0_sck_sleep = "/fragment@24/__overlay__/pri_mi2s_pinctrl:pinctrl-1:0";
		i2s0_sd0_active = "/fragment@24/__overlay__/pri_mi2s_pinctrl:pinctrl-0:8";
		i2s0_ws_active = "/fragment@24/__overlay__/pri_mi2s_pinctrl:pinctrl-0:4";
		i2s0_sck_active = "/fragment@24/__overlay__/pri_mi2s_pinctrl:pinctrl-0:0";
		audio_gpr = "/fragment@24/__overlay__/sound:qcom,msm_audio_ssr_devs:0";
		stub_codec = "/fragment@24/__overlay__/sound:asoc-codec:0";
		spf_core_platform = "/fragment@24:target:0";
		swr4 = "/fragment@23:target:0";
		lpass_bt_swr = "/fragment@22:target:0", "/fragment@27:target:0";
		BOB = "/fragment@21/__overlay__/wcd939x-codec:cdc-vdd-mic-bias-supply:0", "/fragment@21/__overlay__/wcd9378-codec:cdc-vdd-mic-bias-supply:0";
		lpass_core_hw_vote = "/fragment@21/__overlay__/va-macro@7660000/va_swr_master:clocks:0", "/fragment@21/__overlay__/rx-macro@6AC0000/rx_swr_master:clocks:0", "/fragment@21/__overlay__/wsa-macro@6B00000/wsa_swr_master:clocks:0", "/fragment@22/__overlay__:clocks:16", "/fragment@23/__overlay__:clocks:0";
		lpass_audio_hw_vote = "/fragment@21/__overlay__/va-macro@7660000:clocks:0", "/fragment@21/__overlay__/va-macro@7660000/va_swr_master:clocks:8", "/fragment@21/__overlay__/rx-macro@6AC0000/rx_swr_master:clocks:8", "/fragment@21/__overlay__/wsa-macro@6B00000/wsa_swr_master:clocks:8", "/fragment@22/__overlay__:clocks:24", "/fragment@23/__overlay__:clocks:8";
		lpass_cdc = "/fragment@21:target:0", "/fragment@21/__overlay__/wsa-macro@6B00000/wsa_swr_master/wsa884x@02170220:qcom,lpass-cdc-handle:0", "/fragment@21/__overlay__/wsa-macro@6B00000/wsa_swr_master/wsa884x@02170221:qcom,lpass-cdc-handle:0", "/fragment@24/__overlay__/sound:asoc-codec:4", "/fragment@24/__overlay__/sound:qcom,msm_audio_ssr_devs:8";
		lpi_tlmm = "/fragment@20:target:0", "/fragment@24/__overlay__/sound:qcom,msm_audio_ssr_devs:4";
		cam_sensor_suspend_rst3 = "/fragment@19/__overlay__/qcom,eeprom4:pinctrl-1:4", "/fragment@19/__overlay__/qcom,cam-sensor4:pinctrl-1:4";
		cam_sensor_mclk3_suspend = "/fragment@19/__overlay__/qcom,eeprom4:pinctrl-1:0", "/fragment@19/__overlay__/qcom,cam-sensor4:pinctrl-1:0";
		cam_sensor_active_rst3 = "/fragment@19/__overlay__/qcom,eeprom4:pinctrl-0:4", "/fragment@19/__overlay__/qcom,cam-sensor4:pinctrl-0:4";
		cam_sensor_mclk3_active = "/fragment@19/__overlay__/qcom,eeprom4:pinctrl-0:0", "/fragment@19/__overlay__/qcom,cam-sensor4:pinctrl-0:0";
		L4N = "/fragment@19/__overlay__/qcom,eeprom4:cam_v_custom1-supply:0", "/fragment@19/__overlay__/qcom,cam-sensor4:cam_v_custom1-supply:0";
		L6N = "/fragment@19/__overlay__/qcom,eeprom4:cam_vana-supply:0", "/fragment@19/__overlay__/qcom,cam-sensor4:cam_vana-supply:0";
		L2N = "/fragment@19/__overlay__/qcom,eeprom4:cam_vdig-supply:0", "/fragment@19/__overlay__/qcom,cam-sensor4:cam_vdig-supply:0";
		cam_sensor_suspend_rst2 = "/fragment@19/__overlay__/qcom,eeprom3:pinctrl-1:4", "/fragment@19/__overlay__/qcom,cam-sensor3:pinctrl-1:4";
		cam_sensor_mclk2_suspend = "/fragment@19/__overlay__/qcom,eeprom3:pinctrl-1:0", "/fragment@19/__overlay__/qcom,cam-sensor3:pinctrl-1:0";
		cam_sensor_active_rst2 = "/fragment@19/__overlay__/qcom,eeprom3:pinctrl-0:4", "/fragment@19/__overlay__/qcom,cam-sensor3:pinctrl-0:4";
		cam_sensor_mclk2_active = "/fragment@19/__overlay__/qcom,eeprom3:pinctrl-0:0", "/fragment@19/__overlay__/qcom,cam-sensor3:pinctrl-0:0";
		L4M = "/fragment@19/__overlay__/qcom,eeprom3:cam_vana-supply:0", "/fragment@19/__overlay__/qcom,cam-sensor3:cam_vana-supply:0";
		L2M = "/fragment@19/__overlay__/qcom,eeprom3:cam_vdig-supply:0", "/fragment@19/__overlay__/qcom,cam-sensor3:cam_vdig-supply:0";
		cam_cci1 = "/fragment@19:target:0";
		cam_sensor_suspend_rst0 = "/fragment@18/__overlay__/qcom,eeprom1:pinctrl-1:4", "/fragment@18/__overlay__/qcom,cam-sensor1:pinctrl-1:4";
		cam_sensor_mclk0_suspend = "/fragment@18/__overlay__/qcom,eeprom1:pinctrl-1:0", "/fragment@18/__overlay__/qcom,cam-sensor1:pinctrl-1:0";
		cam_sensor_active_rst0 = "/fragment@18/__overlay__/qcom,eeprom1:pinctrl-0:4", "/fragment@18/__overlay__/qcom,cam-sensor1:pinctrl-0:4";
		cam_sensor_mclk0_active = "/fragment@18/__overlay__/qcom,eeprom1:pinctrl-0:0", "/fragment@18/__overlay__/qcom,cam-sensor1:pinctrl-0:0";
		L3M = "/fragment@18/__overlay__/qcom,eeprom1:cam_vana-supply:0", "/fragment@18/__overlay__/qcom,cam-sensor1:cam_vana-supply:0";
		L1M = "/fragment@18/__overlay__/qcom,eeprom1:cam_vdig-supply:0", "/fragment@18/__overlay__/qcom,cam-sensor1:cam_vdig-supply:0";
		cambistmclkcc = "/fragment@18/__overlay__/qcom,eeprom2:clocks:0", "/fragment@18/__overlay__/qcom,eeprom1:clocks:0", "/fragment@18/__overlay__/qcom,cam-sensor1:clocks:0", "/fragment@18/__overlay__/qcom,cam-sensor2:clocks:0", "/fragment@19/__overlay__/qcom,eeprom3:clocks:0", "/fragment@19/__overlay__/qcom,eeprom4:clocks:0", "/fragment@19/__overlay__/qcom,cam-sensor4:clocks:0", "/fragment@19/__overlay__/qcom,cam-sensor3:clocks:0";
		cam_sensor_suspend_rst1 = "/fragment@18/__overlay__/qcom,eeprom2:pinctrl-1:4", "/fragment@18/__overlay__/qcom,cam-sensor2:pinctrl-1:4";
		cam_sensor_mclk1_suspend = "/fragment@18/__overlay__/qcom,eeprom2:pinctrl-1:0", "/fragment@18/__overlay__/qcom,cam-sensor2:pinctrl-1:0";
		cam_sensor_active_rst1 = "/fragment@18/__overlay__/qcom,eeprom2:pinctrl-0:4", "/fragment@18/__overlay__/qcom,cam-sensor2:pinctrl-0:4";
		cam_sensor_mclk1_active = "/fragment@18/__overlay__/qcom,eeprom2:pinctrl-0:0", "/fragment@18/__overlay__/qcom,cam-sensor2:pinctrl-0:0";
		L3N = "/fragment@18/__overlay__/qcom,eeprom2:cam_v_custom1-supply:0", "/fragment@18/__overlay__/qcom,cam-sensor2:cam_v_custom1-supply:0";
		L6M = "/fragment@18/__overlay__/qcom,eeprom2:cam_vana-supply:0", "/fragment@18/__overlay__/qcom,cam-sensor2:cam_vana-supply:0";
		L1N = "/fragment@18/__overlay__/qcom,eeprom2:cam_vdig-supply:0", "/fragment@18/__overlay__/qcom,cam-sensor2:cam_vdig-supply:0";
		cam_cc_titan_top_gdsc = "/fragment@18/__overlay__/qcom,ois0:cam_clk-supply:0", "/fragment@18/__overlay__/qcom,eeprom2:cam_clk-supply:0", "/fragment@18/__overlay__/qcom,eeprom1:cam_clk-supply:0", "/fragment@18/__overlay__/qcom,cam-sensor1:cam_clk-supply:0", "/fragment@18/__overlay__/qcom,cam-sensor2:cam_clk-supply:0", "/fragment@19/__overlay__/qcom,eeprom3:cam_clk-supply:0", "/fragment@19/__overlay__/qcom,eeprom4:cam_clk-supply:0", "/fragment@19/__overlay__/qcom,cam-sensor4:cam_clk-supply:0", "/fragment@19/__overlay__/qcom,cam-sensor3:cam_clk-supply:0";
		L5N = "/fragment@18/__overlay__/qcom,ois0:cam_vio-supply:0", "/fragment@18/__overlay__/qcom,eeprom2:cam_vio-supply:0", "/fragment@18/__overlay__/qcom,eeprom1:cam_vio-supply:0", "/fragment@18/__overlay__/qcom,cam-sensor1:cam_vio-supply:0", "/fragment@18/__overlay__/qcom,cam-sensor2:cam_vio-supply:0", "/fragment@19/__overlay__/qcom,eeprom3:cam_vio-supply:0", "/fragment@19/__overlay__/qcom,eeprom4:cam_vio-supply:0", "/fragment@19/__overlay__/qcom,cam-sensor4:cam_vio-supply:0", "/fragment@19/__overlay__/qcom,cam-sensor3:cam_vio-supply:0";
		L7M = "/fragment@18/__overlay__/qcom,actuator2:cam_vaf-supply:0", "/fragment@18/__overlay__/qcom,actuator1:cam_vaf-supply:0", "/fragment@18/__overlay__/qcom,ois0:cam_vaf-supply:0", "/fragment@18/__overlay__/qcom,eeprom2:cam_vaf-supply:0", "/fragment@18/__overlay__/qcom,eeprom1:cam_vaf-supply:0", "/fragment@18/__overlay__/qcom,cam-sensor1:cam_vaf-supply:0", "/fragment@18/__overlay__/qcom,cam-sensor2:cam_vaf-supply:0", "/fragment@19/__overlay__/qcom,actuator3:cam_vaf-supply:0", "/fragment@19/__overlay__/qcom,eeprom3:cam_vaf-supply:0", "/fragment@19/__overlay__/qcom,cam-sensor3:cam_vaf-supply:0";
		cam_cci0 = "/fragment@18:target:0";
		pmxr2230_switch2 = "/fragment@17/__overlay__/qcom,camera-flash1:switch-source:0", "/fragment@17/__overlay__/qcom,camera-flash2:switch-source:0", "/fragment@17/__overlay__/qcom,camera-flash3:switch-source:0";
		pmxr2230_torch1 = "/fragment@17/__overlay__/qcom,camera-flash1:torch-source:4", "/fragment@17/__overlay__/qcom,camera-flash2:torch-source:4", "/fragment@17/__overlay__/qcom,camera-flash3:torch-source:4";
		pmxr2230_torch0 = "/fragment@17/__overlay__/qcom,camera-flash1:torch-source:0", "/fragment@17/__overlay__/qcom,camera-flash2:torch-source:0", "/fragment@17/__overlay__/qcom,camera-flash3:torch-source:0";
		pmxr2230_flash1 = "/fragment@17/__overlay__/qcom,camera-flash1:flash-source:4", "/fragment@17/__overlay__/qcom,camera-flash2:flash-source:4", "/fragment@17/__overlay__/qcom,camera-flash3:flash-source:4";
		pmxr2230_flash0 = "/fragment@17/__overlay__/qcom,camera-flash1:flash-source:0", "/fragment@17/__overlay__/qcom,camera-flash2:flash-source:0", "/fragment@17/__overlay__/qcom,camera-flash3:flash-source:0";
		soc = "/fragment@17:target:0", "/fragment@25:target:0", "/fragment@30:target:0", "/fragment@35:target:0";
		sdhc_2 = "/fragment@0:target:0";
		L13B = "/fragment@0/__overlay__:vdd-supply:0";
		L23B = "/fragment@0/__overlay__:vdd-io-supply:0";
		sdc2_on = "/fragment@0/__overlay__:pinctrl-0:0";
		sdc2_off = "/fragment@0/__overlay__:pinctrl-1:0";
		tlmm = "/fragment@0/__overlay__:cd-gpios:0", "/fragment@1/__overlay__/goodix-berlin@0:interrupt-parent:0", "/fragment@1/__overlay__/goodix-berlin@0:goodix,reset-gpio:0", "/fragment@1/__overlay__/goodix-berlin@0:goodix,irq-gpio:0", "/fragment@1/__overlay__/goodix-berlin@0:qts,trusted-touch-vm-gpio-list:0", "/fragment@1/__overlay__/goodix-berlin@0:qts,trusted-touch-vm-gpio-list:12", "/fragment@1/__overlay__/goodix-berlin@0:qts,trusted-touch-vm-gpio-list:24", "/fragment@1/__overlay__/goodix-berlin@0:qts,trusted-touch-vm-gpio-list:36", "/fragment@1/__overlay__/goodix-berlin@0:qts,trusted-touch-vm-gpio-list:48", "/fragment@1/__overlay__/goodix-berlin@0:qts,trusted-touch-vm-gpio-list:60", "/fragment@18/__overlay__/qcom,eeprom2:gpios:0", "/fragment@18/__overlay__/qcom,eeprom2:gpios:12", "/fragment@18/__overlay__/qcom,eeprom1:gpios:0", "/fragment@18/__overlay__/qcom,eeprom1:gpios:12", "/fragment@18/__overlay__/qcom,cam-sensor1:gpios:0", "/fragment@18/__overlay__/qcom,cam-sensor1:gpios:12", "/fragment@18/__overlay__/qcom,cam-sensor2:gpios:0", "/fragment@18/__overlay__/qcom,cam-sensor2:gpios:12", "/fragment@19/__overlay__/qcom,eeprom3:gpios:0", "/fragment@19/__overlay__/qcom,eeprom3:gpios:12", "/fragment@19/__overlay__/qcom,eeprom4:gpios:0", "/fragment@19/__overlay__/qcom,eeprom4:gpios:12", "/fragment@19/__overlay__/qcom,cam-sensor4:gpios:0", "/fragment@19/__overlay__/qcom,cam-sensor4:gpios:12", "/fragment@19/__overlay__/qcom,cam-sensor3:gpios:0", "/fragment@19/__overlay__/qcom,cam-sensor3:gpios:12", "/fragment@29:target:0", "/fragment@30/__overlay__/bt_wcn6750:qcom,wl-reset-gpio:0", "/fragment@30/__overlay__/bt_wcn6750:qcom,bt-sw-ctrl-gpio:0", "/fragment@34:target:0";
		qupv3_se8_spi = "/fragment@1:target:0";
		L22B = "/fragment@1/__overlay__/goodix-berlin@0:avdd-supply:0";
		L8B = "/fragment@1/__overlay__/goodix-berlin@0:iovdd-supply:0";
		pmxr2230_sys_therm_11 = "/fragment@2:target:0";
		sys_therm_11 = "/fragment@3:target:0";
		pm8550ve_f_die_temp = "/fragment@4:target:0";
		ufsphy_mem = "/fragment@5:target:0";
		L6B = "/fragment@5/__overlay__:vdda-phy-supply:0";
		L4B = "/fragment@5/__overlay__:vdda-pll-supply:0";
		gcc_ufs_mem_phy_gdsc = "/fragment@5/__overlay__:vdd-phy-gdsc-supply:0";
		L2B = "/fragment@5/__overlay__:vdda-qref-supply:0";
		ufshc_mem = "/fragment@6:target:0";
		gcc_ufs_phy_gdsc = "/fragment@6/__overlay__:vdd-hba-supply:0";
		L12B = "/fragment@6/__overlay__:vcc-supply:0";
		L1D = "/fragment@6/__overlay__:vccq-supply:0";
		L3G = "/fragment@6/__overlay__:qcom,vddp-ref-clk-supply:0", "/fragment@21/__overlay__/wcd939x-codec:cdc-vdd-px-supply:0";
		S2B = "/fragment@6/__overlay__:qcom,vccq-parent-supply:0", "/fragment@30/__overlay__/bt_wcn6750:qcom,bt-vdd-rfa2-supply:0", "/fragment@35/__overlay__/qcom,wcn6750:vdd-1.3-rfa-supply:0";
		spmi_bus = "/fragment@7:target:0";
		pmk8550_vadc = "/fragment@7/__overlay__/qcom,pmiv0108@7/qcom,temp-alarm@a00:io-channels:0", "/fragment@10:target:0", "/fragment@13/__overlay__/sys-therm-7:thermal-sensors:0", "/fragment@13/__overlay__/sys-therm-8:thermal-sensors:0";
		L7B = "/fragment@7/__overlay__/qcom,pmiv0108@7/eusb2-repeater@fd00:vdd18-supply:0", "/fragment@21/__overlay__/wsa-macro@6B00000/wsa_swr_master/wsa884x@02170220:cdc-vdd-1p8-supply:0", "/fragment@21/__overlay__/wsa-macro@6B00000/wsa_swr_master/wsa884x@02170221:cdc-vdd-1p8-supply:0", "/fragment@21/__overlay__/wcd939x-codec:cdc-vdd-rx-supply:0", "/fragment@21/__overlay__/wcd939x-codec:cdc-vdd-tx-supply:0", "/fragment@21/__overlay__/wcd939x-codec:cdc-vdd-buck-supply:0", "/fragment@21/__overlay__/wcd9378-codec:cdc-vdd-rxtx-supply:0", "/fragment@21/__overlay__/wcd9378-codec:cdc-vdd-io-supply:0", "/fragment@21/__overlay__/wcd9378-codec:cdc-vdd-buck-supply:0", "/fragment@33/__overlay__/nq@64:vio-supply:0";
		L17B = "/fragment@7/__overlay__/qcom,pmiv0108@7/eusb2-repeater@fd00:vdd3-supply:0";
		pmk8550_sdam_13 = "/fragment@7/__overlay__/qcom,pmiv0108@7/qcom,amoled-ecm@f900:nvmem:0";
		pmk8550_sdam_14 = "/fragment@7/__overlay__/qcom,pmiv0108@7/qcom,amoled-ecm@f900:nvmem:4";
		pmk8550_sdam_41 = "/fragment@7/__overlay__/qcom,pmiv0108@7/qcom,amoled-ecm@f900:nvmem:8";
		thermal_zones = "/fragment@8:target:0", "/fragment@13:target:0";
		battery_charger = "/fragment@9:target:0";
		sys_therm_6_gpio7_default = "/fragment@10/__overlay__:pinctrl-0:4";
		pmic_glink_debug = "/fragment@11:target:0";
		spmi0_debug_bus = "/fragment@12:target:0";
		modem_nr_scg_dsc = "/fragment@13/__overlay__/pmiv010x-bcl-lvl0/cooling-maps/lbat_0_nr_scg:cooling-device:0", "/fragment@13/__overlay__/pmiv010x-bcl-lvl1/cooling-maps/lbat_1_nr_scg:cooling-device:0";
		modem_nr_dsc = "/fragment@13/__overlay__/pmiv010x-bcl-lvl0/cooling-maps/lbat_0_nr:cooling-device:0", "/fragment@13/__overlay__/pmiv010x-bcl-lvl1/cooling-maps/lbat_1_nr:cooling-device:0";
		modem_lte_dsc = "/fragment@13/__overlay__/pmiv010x-bcl-lvl0/cooling-maps/lbat_0_mdm_lte:cooling-device:0", "/fragment@13/__overlay__/pmiv010x-bcl-lvl1/cooling-maps/lbat_1_mdm_lte:cooling-device:0";
		msm_gpu = "/fragment@13/__overlay__/pmiv010x-bcl-lvl0/cooling-maps/lbat_1_gpu:cooling-device:0", "/fragment@13/__overlay__/pmiv010x-bcl-lvl1/cooling-maps/lbat_1_gpu:cooling-device:0", "/fragment@13/__overlay__/pmiv010x-bcl-lvl2/cooling-maps/lbat_2_gpu:cooling-device:0", "/fragment@13/__overlay__/socd/cooling-maps/socd_gpu0:cooling-device:0";
		APC1_MX_CX_PAUSE = "/fragment@13/__overlay__/socd/cooling-maps/socd_apc1:cooling-device:0";
		cdsp_sw = "/fragment@13/__overlay__/socd/cooling-maps/socd_cdsp1:cooling-device:0";
		eusb2_phy0 = "/fragment@14:target:0", "/fragment@15:target:0";
		pcie1 = "/fragment@16:target:0";
	};

	__local_fixups__ {

		fragment@8 {

			__overlay__ {

				pmiv010x_tz {
					thermal-sensors = <0x00>;
				};

				pmiv010x-ibat-lvl0 {
					thermal-sensors = <0x00>;
				};

				pmiv010x-ibat-lvl1 {
					thermal-sensors = <0x00>;
				};

				pmiv010x-bcl-lvl0 {
					thermal-sensors = <0x00>;
				};

				pmiv010x-bcl-lvl1 {
					thermal-sensors = <0x00>;
				};

				pmiv010x-bcl-lvl2 {
					thermal-sensors = <0x00>;
				};

				socd {
					thermal-sensors = <0x00>;
				};

				vbat {
					thermal-sensors = <0x00>;
				};
			};
		};

		fragment@10 {

			__overlay__ {
				pinctrl-0 = <0x00>;
			};
		};

		fragment@13 {

			__overlay__ {

				pmiv010x-bcl-lvl0 {

					cooling-maps {

						lbat_0_nr_scg {
							trip = <0x00>;
						};

						lbat_0_nr {
							trip = <0x00>;
						};

						lbat_0_mdm_lte {
							trip = <0x00>;
						};

						lbat_1_gpu {
							trip = <0x00>;
						};
					};
				};

				pmiv010x-bcl-lvl1 {

					cooling-maps {

						lbat_1_nr_scg {
							trip = <0x00>;
						};

						lbat_1_nr {
							trip = <0x00>;
						};

						lbat_1_mdm_lte {
							trip = <0x00>;
						};

						lbat_1_gpu {
							trip = <0x00>;
						};
					};
				};

				pmiv010x-bcl-lvl2 {

					cooling-maps {

						lbat_2_gpu {
							trip = <0x00>;
						};
					};
				};

				socd {

					cooling-maps {

						socd_apc1 {
							trip = <0x00>;
						};

						socd_cdsp1 {
							trip = <0x00>;
						};

						socd_gpu0 {
							trip = <0x00>;
						};
					};
				};
			};
		};

		fragment@14 {

			__overlay__ {
				dummy-supply = <0x00>;
				usb-repeater = <0x00>;
			};
		};

		fragment@15 {

			__overlay__ {
				dummy-supply = <0x00>;
				usb-repeater = <0x00>;
			};
		};

		fragment@18 {

			__overlay__ {

				qcom,cam-sensor1 {
					led-flash-src = <0x00>;
					actuator-src = <0x00>;
					eeprom-src = <0x00>;
				};

				qcom,cam-sensor2 {
					led-flash-src = <0x00>;
					actuator-src = <0x00>;
					ois-src = <0x00>;
					eeprom-src = <0x00>;
				};
			};
		};

		fragment@19 {

			__overlay__ {

				qcom,cam-sensor4 {
					eeprom-src = <0x00>;
				};

				qcom,cam-sensor3 {
					led-flash-src = <0x00>;
					actuator-src = <0x00>;
					eeprom-src = <0x00>;
				};
			};
		};

		fragment@21 {

			__overlay__ {

				lpass-cdc-clk-rsc-mngr {
					clocks = <0x00 0x08 0x10 0x18>;
				};

				va-macro@7660000 {
					qcom,va-swr-gpios = <0x00>;
				};

				rx-macro@6AC0000 {
					clocks = <0x00>;
					qcom,rx-swr-gpios = <0x00>;
				};

				wsa-macro@6B00000 {
					qcom,wsa-swr-gpios = <0x00>;

					wsa_swr_master {

						wsa884x@02170220 {
							qcom,wsa-macro-handle = <0x00>;
							qcom,spkr-sd-n-node = <0x00>;
						};

						wsa884x@02170221 {
							qcom,wsa-macro-handle = <0x00>;
							qcom,spkr-sd-n-node = <0x00>;
						};
					};
				};

				wcd939x-codec {
					qcom,tx-slave = <0x00>;
					qcom,rx-slave = <0x00>;
					qcom,wcd-rst-gpio-node = <0x00>;
				};

				wcd9378-codec {
					qcom,tx-slave = <0x00>;
					qcom,rx-slave = <0x00>;
					qcom,wcd-rst-gpio-node = <0x00>;
				};
			};
		};

		fragment@22 {

			__overlay__ {
				qcom,bt-swr-gpios = <0x00>;
				clocks = <0x00 0x08>;
			};
		};

		fragment@24 {

			__overlay__ {

				sound {
					qcom,cdc-dmic67-gpios = <0x00>;
					qcom,sep-mi2s-gpios = <0x00>;
					qcom,sen-mi2s-gpios = <0x00>;
					qcom,quin-mi2s-gpios = <0x00>;
					qcom,quat-mi2s-gpios = <0x00>;
					qcom,pri-mi2s-gpios = <0x00>;
					qcom,cdc-dmic23-gpios = <0x00>;
					qcom,cdc-dmic01-gpios = <0x00>;
					asoc-codec = <0x08 0x0c 0x10>;
				};

				quat_mi2s_pinctrl {
					pinctrl-1 = <0x00 0x04 0x08 0x0c 0x10 0x14>;
					pinctrl-0 = <0x00 0x04 0x08 0x0c 0x10 0x14>;
				};

				quin_mi2s_pinctrl {
					pinctrl-1 = <0x00 0x04 0x08 0x0c>;
					pinctrl-0 = <0x00 0x04 0x08 0x0c>;
				};

				sen_mi2s_pinctrl {
					pinctrl-1 = <0x00 0x04 0x08 0x0c>;
					pinctrl-0 = <0x00 0x04 0x08 0x0c>;
				};

				sep_mi2s_pinctrl {
					pinctrl-1 = <0x00 0x04 0x08 0x0c>;
					pinctrl-0 = <0x00 0x04 0x08 0x0c>;
				};

				wsa_swr_clk_data_pinctrl {
					pinctrl-1 = <0x00 0x04>;
					pinctrl-0 = <0x00 0x04>;
				};

				rx_swr_clk_data_pinctrl {
					pinctrl-1 = <0x00 0x04 0x08>;
					pinctrl-0 = <0x00 0x04 0x08>;
				};

				tx_swr_clk_data_pinctrl {
					pinctrl-1 = <0x00 0x04 0x08 0x0c>;
					pinctrl-0 = <0x00 0x04 0x08 0x0c>;
				};

				cdc_dmic01_pinctrl {
					pinctrl-1 = <0x00 0x04>;
					pinctrl-0 = <0x00 0x04>;
				};

				cdc_dmic23_pinctrl {
					pinctrl-1 = <0x00 0x04>;
					pinctrl-0 = <0x00 0x04>;
				};

				cdc_dmic45_pinctrl {
					pinctrl-1 = <0x00 0x04>;
					pinctrl-0 = <0x00 0x04>;
				};

				cdc_dmic67_pinctrl {
					pinctrl-1 = <0x00 0x04>;
					pinctrl-0 = <0x00 0x04>;
				};

				bt_swr_clk_data_pinctrl {
					pinctrl-1 = <0x00 0x04>;
					pinctrl-0 = <0x00 0x04>;
				};
			};
		};

		fragment@30 {

			__overlay__ {

				bt_wcn6750 {
					pinctrl-1 = <0x00>;
					pinctrl-0 = <0x00>;
				};
			};
		};

		fragment@35 {

			__overlay__ {

				qcom,wcn6750 {
					qcom,smem-states = <0x00 0x08 0x10>;
					pinctrl-0 = <0x00>;

					qcom,smp2p_map_wlan_1_in {
						interrupts-extended = <0x00 0x0c>;
					};

					qcom,smp2p_map_wlan_2_in {
						interrupts-extended = <0x00>;
					};
				};
			};
		};
	};

	fragment@17 {
		target = <0xffffffff>;

		__overlay__ {

			qcom,camera-flash1 {
				phandle = <0x21>;
				status = "ok";
				switch-source = <0xffffffff>;
				torch-source = <0xffffffff 0xffffffff>;
				flash-source = <0xffffffff 0xffffffff>;
				compatible = "qcom,camera-flash";
				cell-index = <0x01>;
			};

			qcom,camera-flash2 {
				phandle = <0x25>;
				status = "ok";
				switch-source = <0xffffffff>;
				torch-source = <0xffffffff 0xffffffff>;
				flash-source = <0xffffffff 0xffffffff>;
				compatible = "qcom,camera-flash";
				cell-index = <0x02>;
			};

			qcom,camera-flash3 {
				phandle = <0x1d>;
				status = "ok";
				switch-source = <0xffffffff>;
				torch-source = <0xffffffff 0xffffffff>;
				flash-source = <0xffffffff 0xffffffff>;
				compatible = "qcom,camera-flash";
				cell-index = <0x03>;
			};

			qcom,cam-res-mgr {
				status = "ok";
				compatible = "qcom,cam-res-mgr";
			};
		};
	};

	fragment@18 {
		target = <0xffffffff>;

		__overlay__ {

			qcom,actuator2 {
				phandle = <0x20>;
				status = "ok";
				rgltr-load-current = <0x1d092>;
				rgltr-max-voltage = <0x2dc6c0>;
				rgltr-min-voltage = <0x2ab980>;
				rgltr-cntrl-support;
				regulator-names = "cam_vaf";
				cam_vaf-supply = <0xffffffff>;
				cci-master = <0x01>;
				compatible = "qcom,actuator";
				cell-index = <0x02>;
			};

			qcom,actuator1 {
				phandle = <0x1c>;
				status = "ok";
				rgltr-load-current = <0x193c0>;
				rgltr-max-voltage = <0x2dc6c0>;
				rgltr-min-voltage = <0x2ab980>;
				rgltr-cntrl-support;
				regulator-names = "cam_vaf";
				cam_vaf-supply = <0xffffffff>;
				cci-master = <0x00>;
				compatible = "qcom,actuator";
				cell-index = <0x01>;
			};

			qcom,ois0 {
				phandle = <0x1f>;
				status = "ok";
				rgltr-load-current = <0xdac 0x35b60 0x00>;
				rgltr-max-voltage = <0x1e3660 0x2dc6c0 0x00>;
				rgltr-min-voltage = <0x1b7740 0x2ab980 0x00>;
				rgltr-cntrl-support;
				regulator-names = "cam_vio", "cam_vaf", "cam_clk";
				cam_clk-supply = <0xffffffff>;
				cam_vaf-supply = <0xffffffff>;
				cam_vio-supply = <0xffffffff>;
				cci-master = <0x01>;
				compatible = "qcom,ois";
				cell-index = <0x02>;
			};

			qcom,eeprom2 {
				phandle = <0x1e>;
				status = "ok";
				clock-rates = <0x16e3600>;
				clock-cntl-level = "nominal";
				clock-names = "cam_clk";
				clocks = <0xffffffff 0x02>;
				cci-master = <0x01>;
				gpio-req-tbl-label = "CAMIF_MCLK1", "CAM_RESET1";
				gpio-req-tbl-flags = <0x01 0x00>;
				gpio-req-tbl-num = <0x00 0x01>;
				gpio-reset = <0x01>;
				gpios = <0xffffffff 0x42 0x00 0xffffffff 0x7c 0x00>;
				pinctrl-1 = <0xffffffff 0xffffffff>;
				pinctrl-0 = <0xffffffff 0xffffffff>;
				pinctrl-names = "cam_default", "cam_suspend";
				gpio-no-mux = <0x00>;
				rgltr-load-current = <0xdac 0xdef30 0x00 0x16526 0x1d092 0xf67c>;
				rgltr-max-voltage = <0x1e3660 0x124f80 0x00 0x2c4020 0x2dc6c0 0x1cfde0>;
				rgltr-min-voltage = <0x1b7740 0x10d880 0x00 0x2ab980 0x2ab980 0x1b7740>;
				rgltr-cntrl-support;
				regulator-names = "cam_vio", "cam_vdig", "cam_clk", "cam_vana", "cam_vaf", "cam_v_custom1";
				cam_v_custom1-supply = <0xffffffff>;
				cam_vaf-supply = <0xffffffff>;
				cam_vana-supply = <0xffffffff>;
				cam_clk-supply = <0xffffffff>;
				cam_vdig-supply = <0xffffffff>;
				cam_vio-supply = <0xffffffff>;
				compatible = "qcom,eeprom";
				cell-index = <0x02>;
			};

			qcom,eeprom1 {
				phandle = <0x1b>;
				status = "ok";
				clock-rates = <0x16e3600>;
				clock-cntl-level = "nominal";
				clock-names = "cam_clk";
				clocks = <0xffffffff 0x00>;
				cci-master = <0x00>;
				gpio-req-tbl-label = "CAMIF_MCLK0", "CAM_RESET0";
				gpio-req-tbl-flags = <0x01 0x00>;
				gpio-req-tbl-num = <0x00 0x01>;
				gpio-reset = <0x01>;
				gpios = <0xffffffff 0x41 0x00 0xffffffff 0x7b 0x00>;
				pinctrl-1 = <0xffffffff 0xffffffff>;
				pinctrl-0 = <0xffffffff 0xffffffff>;
				pinctrl-names = "cam_default", "cam_suspend";
				gpio-no-mux = <0x00>;
				rgltr-load-current = <0xfdc 0x7fd78 0x00 0x1a3ec 0x193c0>;
				rgltr-max-voltage = <0x1e3660 0x124f80 0x00 0x2c4020 0x2dc6c0>;
				rgltr-min-voltage = <0x1b7740 0x10c8e0 0x00 0x2ab980 0x2ab980>;
				rgltr-cntrl-support;
				regulator-names = "cam_vio", "cam_vdig", "cam_clk", "cam_vana", "cam_vaf";
				cam_vaf-supply = <0xffffffff>;
				cam_vana-supply = <0xffffffff>;
				cam_clk-supply = <0xffffffff>;
				cam_vdig-supply = <0xffffffff>;
				cam_vio-supply = <0xffffffff>;
				compatible = "qcom,eeprom";
				cell-index = <0x01>;
			};

			qcom,cam-sensor1 {
				status = "ok";
				clock-rates = <0x16e3600>;
				clock-cntl-level = "nominal";
				clock-names = "cam_clk";
				clocks = <0xffffffff 0x00>;
				cci-master = <0x00>;
				gpio-req-tbl-label = "CAMIF_MCLK0", "CAM_RESET0";
				gpio-req-tbl-flags = <0x01 0x00>;
				gpio-req-tbl-num = <0x00 0x01>;
				gpio-reset = <0x01>;
				gpios = <0xffffffff 0x41 0x00 0xffffffff 0x7b 0x00>;
				pinctrl-1 = <0xffffffff 0xffffffff>;
				pinctrl-0 = <0xffffffff 0xffffffff>;
				pinctrl-names = "cam_default", "cam_suspend";
				gpio-no-mux = <0x00>;
				rgltr-load-current = <0xfdc 0x7fd78 0x00 0x1a3ec 0x193c0>;
				rgltr-max-voltage = <0x1e3660 0x124f80 0x00 0x2c4020 0x2dc6c0>;
				rgltr-min-voltage = <0x1b7740 0x10c8e0 0x00 0x2ab980 0x2ab980>;
				rgltr-cntrl-support;
				regulator-names = "cam_vio", "cam_vdig", "cam_clk", "cam_vana", "cam_vaf";
				cam_vaf-supply = <0xffffffff>;
				cam_vana-supply = <0xffffffff>;
				cam_clk-supply = <0xffffffff>;
				cam_vdig-supply = <0xffffffff>;
				cam_vio-supply = <0xffffffff>;
				led-flash-src = <0x1d>;
				actuator-src = <0x1c>;
				eeprom-src = <0x1b>;
				sensor-position-yaw = <0xb4>;
				sensor-position-pitch = <0x00>;
				sensor-position-roll = <0x5a>;
				csiphy-sd-index = <0x00>;
				compatible = "qcom,cam-sensor";
				cell-index = <0x01>;
			};

			qcom,cam-sensor2 {
				status = "ok";
				clock-rates = <0x16e3600>;
				clock-cntl-level = "nominal";
				clock-names = "cam_clk";
				clocks = <0xffffffff 0x02>;
				cci-master = <0x01>;
				gpio-req-tbl-label = "CAMIF_MCLK1", "CAM_RESET1";
				gpio-req-tbl-flags = <0x01 0x00>;
				gpio-req-tbl-num = <0x00 0x01>;
				gpio-reset = <0x01>;
				gpios = <0xffffffff 0x42 0x00 0xffffffff 0x7c 0x00>;
				pinctrl-1 = <0xffffffff 0xffffffff>;
				pinctrl-0 = <0xffffffff 0xffffffff>;
				pinctrl-names = "cam_default", "cam_suspend";
				gpio-no-mux = <0x00>;
				rgltr-load-current = <0xdac 0xdef30 0x00 0x16526 0x1d092 0xf67c>;
				rgltr-max-voltage = <0x1e3660 0x124f80 0x00 0x2c4020 0x2dc6c0 0x1cfde0>;
				rgltr-min-voltage = <0x1b7740 0x10d880 0x00 0x2ab980 0x2ab980 0x1b7740>;
				rgltr-cntrl-support;
				regulator-names = "cam_vio", "cam_vdig", "cam_clk", "cam_vana", "cam_vaf", "cam_v_custom1";
				cam_v_custom1-supply = <0xffffffff>;
				cam_vaf-supply = <0xffffffff>;
				cam_vana-supply = <0xffffffff>;
				cam_clk-supply = <0xffffffff>;
				cam_vdig-supply = <0xffffffff>;
				cam_vio-supply = <0xffffffff>;
				led-flash-src = <0x21>;
				actuator-src = <0x20>;
				ois-src = <0x1f>;
				eeprom-src = <0x1e>;
				sensor-position-yaw = <0xb4>;
				sensor-position-pitch = <0x00>;
				sensor-position-roll = <0x5a>;
				csiphy-sd-index = <0x01>;
				compatible = "qcom,cam-sensor";
				cell-index = <0x02>;
			};
		};
	};

	fragment@19 {
		target = <0xffffffff>;

		__overlay__ {

			qcom,actuator3 {
				phandle = <0x24>;
				status = "ok";
				rgltr-load-current = <0x1fbf8>;
				rgltr-max-voltage = <0x2dc6c0>;
				rgltr-min-voltage = <0x2ab980>;
				rgltr-cntrl-support;
				regulator-names = "cam_vaf";
				cam_vaf-supply = <0xffffffff>;
				cci-master = <0x00>;
				compatible = "qcom,actuator";
				cell-index = <0x03>;
			};

			qcom,eeprom3 {
				phandle = <0x23>;
				status = "ok";
				clock-rates = <0x16e3600>;
				clock-cntl-level = "nominal";
				clock-names = "cam_clk";
				clocks = <0xffffffff 0x04>;
				cci-master = <0x00>;
				gpio-req-tbl-label = "CAMIF_MCLK2", "CAM_RESET2";
				gpio-req-tbl-flags = <0x01 0x00>;
				gpio-req-tbl-num = <0x00 0x01>;
				gpio-reset = <0x01>;
				gpios = <0xffffffff 0x43 0x00 0xffffffff 0x7d 0x00>;
				pinctrl-1 = <0xffffffff 0xffffffff>;
				pinctrl-0 = <0xffffffff 0xffffffff>;
				pinctrl-names = "cam_default", "cam_suspend";
				gpio-no-mux = <0x00>;
				rgltr-load-current = <0x1194 0x4105a 0x00 0x10d88 0x1fbf8>;
				rgltr-max-voltage = <0x1e3660 0x118c30 0x00 0x2c4020 0x2dc6c0>;
				rgltr-min-voltage = <0x1b7740 0x101d00 0x00 0x2ab980 0x2ab980>;
				rgltr-cntrl-support;
				regulator-names = "cam_vio", "cam_vdig", "cam_clk", "cam_vana", "cam_vaf";
				cam_vaf-supply = <0xffffffff>;
				cam_vana-supply = <0xffffffff>;
				cam_clk-supply = <0xffffffff>;
				cam_vdig-supply = <0xffffffff>;
				cam_vio-supply = <0xffffffff>;
				compatible = "qcom,eeprom";
				cell-index = <0x03>;
			};

			qcom,eeprom4 {
				phandle = <0x22>;
				status = "ok";
				clock-rates = <0x16e3600>;
				clock-cntl-level = "nominal";
				clock-names = "cam_clk";
				clocks = <0xffffffff 0x06>;
				cci-master = <0x01>;
				gpio-req-tbl-label = "CAMIF_MCLK3", "CAM_RESET3";
				gpio-req-tbl-flags = <0x01 0x00>;
				gpio-req-tbl-num = <0x00 0x01>;
				gpio-reset = <0x01>;
				gpios = <0xffffffff 0x44 0x00 0xffffffff 0x7e 0x00>;
				pinctrl-1 = <0xffffffff 0xffffffff>;
				pinctrl-0 = <0xffffffff 0xffffffff>;
				pinctrl-names = "cam_default", "cam_suspend";
				gpio-no-mux = <0x00>;
				rgltr-load-current = <0x15b8 0x6ee92 0x00 0x13024 0x7300>;
				rgltr-max-voltage = <0x1e3660 0x118c30 0x00 0x2c4020 0x1cfde0>;
				rgltr-min-voltage = <0x1b7740 0x101d00 0x00 0x2ab980 0x1b7740>;
				rgltr-cntrl-support;
				regulator-names = "cam_vio", "cam_vdig", "cam_clk", "cam_vana", "cam_v_custom1";
				cam_v_custom1-supply = <0xffffffff>;
				cam_vana-supply = <0xffffffff>;
				cam_clk-supply = <0xffffffff>;
				cam_vdig-supply = <0xffffffff>;
				cam_vio-supply = <0xffffffff>;
				compatible = "qcom,eeprom";
				cell-index = <0x04>;
			};

			qcom,cam-sensor4 {
				status = "ok";
				clock-rates = <0x16e3600>;
				clock-cntl-level = "nominal";
				clock-names = "cam_clk";
				clocks = <0xffffffff 0x06>;
				cci-master = <0x01>;
				gpio-req-tbl-label = "CAMIF_MCLK3", "CAM_RESET3";
				gpio-req-tbl-flags = <0x01 0x00>;
				gpio-req-tbl-num = <0x00 0x01>;
				gpio-reset = <0x01>;
				gpios = <0xffffffff 0x44 0x00 0xffffffff 0x7e 0x00>;
				pinctrl-1 = <0xffffffff 0xffffffff>;
				pinctrl-0 = <0xffffffff 0xffffffff>;
				pinctrl-names = "cam_default", "cam_suspend";
				gpio-no-mux = <0x00>;
				rgltr-load-current = <0x15b8 0x6ee92 0x00 0x13024 0x7300>;
				rgltr-max-voltage = <0x1e3660 0x118c30 0x00 0x2c4020 0x1cfde0>;
				rgltr-min-voltage = <0x1b7740 0x101d00 0x00 0x2ab980 0x1b7740>;
				rgltr-cntrl-support;
				regulator-names = "cam_vio", "cam_vdig", "cam_clk", "cam_vana", "cam_v_custom1";
				cam_v_custom1-supply = <0xffffffff>;
				cam_vana-supply = <0xffffffff>;
				cam_clk-supply = <0xffffffff>;
				cam_vdig-supply = <0xffffffff>;
				cam_vio-supply = <0xffffffff>;
				eeprom-src = <0x22>;
				sensor-position-yaw = <0x00>;
				sensor-position-pitch = <0x00>;
				sensor-position-roll = <0x5a>;
				csiphy-sd-index = <0x03>;
				compatible = "qcom,cam-sensor";
				cell-index = <0x04>;
			};

			qcom,cam-sensor3 {
				status = "ok";
				clock-rates = <0x16e3600>;
				clock-cntl-level = "nominal";
				clock-names = "cam_clk";
				clocks = <0xffffffff 0x04>;
				cci-master = <0x00>;
				gpio-req-tbl-label = "CAMIF_MCLK2", "CAM_RESET2";
				gpio-req-tbl-flags = <0x01 0x00>;
				gpio-req-tbl-num = <0x00 0x01>;
				gpio-reset = <0x01>;
				gpios = <0xffffffff 0x43 0x00 0xffffffff 0x7d 0x00>;
				pinctrl-1 = <0xffffffff 0xffffffff>;
				pinctrl-0 = <0xffffffff 0xffffffff>;
				pinctrl-names = "cam_default", "cam_suspend";
				gpio-no-mux = <0x00>;
				rgltr-load-current = <0x1194 0x4105a 0x00 0x10d88 0x1fbf8>;
				rgltr-max-voltage = <0x1e3660 0x118c30 0x00 0x2c4020 0x2dc6c0>;
				rgltr-min-voltage = <0x1b7740 0x101d00 0x00 0x2ab980 0x2ab980>;
				rgltr-cntrl-support;
				regulator-names = "cam_vio", "cam_vdig", "cam_clk", "cam_vana", "cam_vaf";
				cam_vaf-supply = <0xffffffff>;
				cam_vana-supply = <0xffffffff>;
				cam_clk-supply = <0xffffffff>;
				cam_vdig-supply = <0xffffffff>;
				cam_vio-supply = <0xffffffff>;
				led-flash-src = <0x25>;
				actuator-src = <0x24>;
				eeprom-src = <0x23>;
				sensor-position-yaw = <0xb4>;
				sensor-position-pitch = <0x00>;
				sensor-position-roll = <0x5a>;
				csiphy-sd-index = <0x02>;
				compatible = "qcom,cam-sensor";
				cell-index = <0x03>;
			};
		};
	};

	fragment@20 {
		target = <0xffffffff>;

		__overlay__ {

			quat_mi2s_sck {

				quat_mi2s_sck_sleep {
					phandle = <0x4a>;

					mux {
						function = "func2";
						pins = "gpio0";
					};

					config {
						input-enable;
						bias-pull-down;
						drive-strength = <0x02>;
						pins = "gpio0";
					};
				};

				quat_mi2s_sck_active {
					phandle = <0x44>;

					mux {
						function = "func2";
						pins = "gpio0";
					};

					config {
						output-high;
						bias-disable;
						drive-strength = <0x08>;
						pins = "gpio0";
					};
				};
			};

			quat_mi2s_ws {

				quat_mi2s_ws_sleep {
					phandle = <0x4b>;

					mux {
						function = "func2";
						pins = "gpio1";
					};

					config {
						input-enable;
						bias-pull-down;
						drive-strength = <0x02>;
						pins = "gpio1";
					};
				};

				quat_mi2s_ws_active {
					phandle = <0x45>;

					mux {
						function = "func2";
						pins = "gpio1";
					};

					config {
						output-high;
						bias-disable;
						drive-strength = <0x08>;
						pins = "gpio1";
					};
				};
			};

			quat_mi2s_sd0 {

				quat_mi2s_sd0_sleep {
					phandle = <0x4c>;

					mux {
						function = "func2";
						pins = "gpio2";
					};

					config {
						input-enable;
						bias-pull-down;
						drive-strength = <0x02>;
						pins = "gpio2";
					};
				};

				quat_mi2s_sd0_active {
					phandle = <0x46>;

					mux {
						function = "func2";
						pins = "gpio2";
					};

					config {
						output-high;
						bias-disable;
						drive-strength = <0x08>;
						pins = "gpio2";
					};
				};
			};

			quat_mi2s_sd1 {

				quat_mi2s_sd1_sleep {
					phandle = <0x4d>;

					mux {
						function = "func2";
						pins = "gpio3";
					};

					config {
						input-enable;
						bias-pull-down;
						drive-strength = <0x02>;
						pins = "gpio3";
					};
				};

				quat_mi2s_sd1_active {
					phandle = <0x47>;

					mux {
						function = "func2";
						pins = "gpio3";
					};

					config {
						output-high;
						bias-disable;
						drive-strength = <0x08>;
						pins = "gpio3";
					};
				};
			};

			quat_mi2s_sd2 {

				quat_mi2s_sd2_sleep {
					phandle = <0x4e>;

					mux {
						function = "func2";
						pins = "gpio4";
					};

					config {
						input-enable;
						bias-pull-down;
						drive-strength = <0x02>;
						pins = "gpio4";
					};
				};

				quat_mi2s_sd2_active {
					phandle = <0x48>;

					mux {
						function = "func2";
						pins = "gpio4";
					};

					config {
						output-high;
						bias-disable;
						drive-strength = <0x08>;
						pins = "gpio4";
					};
				};
			};

			quat_mi2s_sd3 {

				quat_mi2s_sd3_sleep {
					phandle = <0x4f>;

					mux {
						function = "func3";
						pins = "gpio5";
					};

					config {
						input-enable;
						bias-pull-down;
						drive-strength = <0x02>;
						pins = "gpio5";
					};
				};

				quat_mi2s_sd3_active {
					phandle = <0x49>;

					mux {
						function = "func3";
						pins = "gpio5";
					};

					config {
						output-high;
						bias-disable;
						drive-strength = <0x08>;
						pins = "gpio5";
					};
				};
			};

			lpi_i2s1_sck {

				lpi_i2s1_sck_sleep {
					phandle = <0x54>;

					mux {
						function = "func2";
						pins = "gpio6";
					};

					config {
						input-enable;
						bias-pull-down;
						drive-strength = <0x02>;
						pins = "gpio6";
					};
				};

				lpi_i2s1_sck_active {
					phandle = <0x50>;

					mux {
						function = "func2";
						pins = "gpio6";
					};

					config {
						output-high;
						bias-disable;
						drive-strength = <0x08>;
						pins = "gpio6";
					};
				};
			};

			lpi_i2s1_ws {

				lpi_i2s1_ws_sleep {
					phandle = <0x55>;

					mux {
						function = "func2";
						pins = "gpio7";
					};

					config {
						input-enable;
						bias-pull-down;
						drive-strength = <0x02>;
						pins = "gpio7";
					};
				};

				lpi_i2s1_ws_active {
					phandle = <0x51>;

					mux {
						function = "func2";
						pins = "gpio7";
					};

					config {
						output-high;
						bias-disable;
						drive-strength = <0x08>;
						pins = "gpio7";
					};
				};
			};

			lpi_i2s1_sd0 {

				lpi_i2s1_data0_sleep {
					phandle = <0x56>;

					mux {
						function = "func2";
						pins = "gpio8";
					};

					config {
						input-enable;
						bias-pull-down;
						drive-strength = <0x02>;
						pins = "gpio8";
					};
				};

				lpi_i2s1_data0_active {
					phandle = <0x52>;

					mux {
						function = "func2";
						pins = "gpio8";
					};

					config {
						bias-pull-down;
						drive-strength = <0x08>;
						pins = "gpio8";
					};
				};
			};

			lpi_i2s1_sd1 {

				lpi_i2s1_data1_active {
					phandle = <0x53>;

					mux {
						function = "func2";
						pins = "gpio9";
					};

					config {
						output-high;
						bias-disable;
						drive-strength = <0x08>;
						pins = "gpio9";
					};
				};

				lpi_i2s1_data1_sleep {
					phandle = <0x57>;

					mux {
						function = "func2";
						pins = "gpio9";
					};

					config {
						input-enable;
						bias-pull-down;
						drive-strength = <0x02>;
						pins = "gpio9";
					};
				};
			};

			lpi_i2s2_sck {

				lpi_i2s2_sck_active {
					phandle = <0x58>;

					mux {
						function = "func2";
						pins = "gpio10";
					};

					config {
						output-high;
						bias-disable;
						drive-strength = <0x08>;
						pins = "gpio10";
					};
				};

				lpi_i2s2_sck_sleep {
					phandle = <0x5c>;

					mux {
						function = "func2";
						pins = "gpio10";
					};

					config {
						input-enable;
						bias-pull-down;
						drive-strength = <0x02>;
						pins = "gpio10";
					};
				};
			};

			lpi_i2s2_ws {

				lpi_i2s2_ws_active {
					phandle = <0x59>;

					mux {
						function = "func2";
						pins = "gpio11";
					};

					config {
						output-high;
						bias-disable;
						drive-strength = <0x08>;
						pins = "gpio11";
					};
				};

				lpi_i2s2_ws_sleep {
					phandle = <0x5d>;

					mux {
						function = "func2";
						pins = "gpio11";
					};

					config {
						input-enable;
						bias-pull-down;
						drive-strength = <0x02>;
						pins = "gpio11";
					};
				};
			};

			lpi_i2s2_sd0 {

				lpi_i2s2_data0_active {
					phandle = <0x5a>;

					mux {
						function = "func2";
						pins = "gpio12";
					};

					config {
						output-high;
						bias-disable;
						drive-strength = <0x08>;
						pins = "gpio12";
					};
				};

				lpi_i2s2_data0_sleep {
					phandle = <0x5e>;

					mux {
						function = "func2";
						pins = "gpio12";
					};

					config {
						input-enable;
						bias-pull-down;
						drive-strength = <0x02>;
						pins = "gpio12";
					};
				};
			};

			lpi_i2s2_sd1 {

				lpi_i2s2_data1_active {
					phandle = <0x5b>;

					mux {
						function = "func2";
						pins = "gpio13";
					};

					config {
						output-high;
						bias-disable;
						drive-strength = <0x08>;
						pins = "gpio13";
					};
				};

				lpi_i2s2_data1_sleep {
					phandle = <0x5f>;

					mux {
						function = "func2";
						pins = "gpio13";
					};

					config {
						input-enable;
						bias-pull-down;
						drive-strength = <0x02>;
						pins = "gpio13";
					};
				};
			};

			lpi_i2s3_sck {

				lpi_i2s3_sck_active {
					phandle = <0x60>;

					mux {
						function = "func1";
						pins = "gpio19";
					};

					config {
						output-high;
						bias-disable;
						drive-strength = <0x08>;
						pins = "gpio19";
					};
				};

				lpi_i2s3_sck_sleep {
					phandle = <0x64>;

					mux {
						function = "func1";
						pins = "gpio19";
					};

					config {
						input-enable;
						bias-pull-down;
						drive-strength = <0x02>;
						pins = "gpio19";
					};
				};
			};

			lpi_i2s3_ws {

				lpi_i2s3_ws_active {
					phandle = <0x61>;

					mux {
						function = "func1";
						pins = "gpio20";
					};

					config {
						output-high;
						bias-disable;
						drive-strength = <0x08>;
						pins = "gpio20";
					};
				};

				lpi_i2s3_ws_sleep {
					phandle = <0x65>;

					mux {
						function = "func1";
						pins = "gpio20";
					};

					config {
						input-enable;
						bias-pull-down;
						drive-strength = <0x02>;
						pins = "gpio20";
					};
				};
			};

			lpi_i2s3_sd0 {

				lpi_i2s3_data0_active {
					phandle = <0x62>;

					mux {
						function = "func1";
						pins = "gpio21";
					};

					config {
						output-high;
						bias-disable;
						drive-strength = <0x08>;
						pins = "gpio21";
					};
				};

				lpi_i2s3_data0_sleep {
					phandle = <0x66>;

					mux {
						function = "func1";
						pins = "gpio21";
					};

					config {
						input-enable;
						bias-pull-down;
						drive-strength = <0x02>;
						pins = "gpio21";
					};
				};
			};

			lpi_i2s3_sd1 {

				lpi_i2s3_data1_active {
					phandle = <0x63>;

					mux {
						function = "func1";
						pins = "gpio22";
					};

					config {
						output-high;
						bias-disable;
						drive-strength = <0x08>;
						pins = "gpio22";
					};
				};

				lpi_i2s3_data1_sleep {
					phandle = <0x67>;

					mux {
						function = "func1";
						pins = "gpio22";
					};

					config {
						input-enable;
						bias-pull-down;
						drive-strength = <0x02>;
						pins = "gpio22";
					};
				};
			};

			quat_tdm_ws {

				quat_tdm_ws_sleep {
					phandle = <0x8e>;

					mux {
						function = "func2";
						pins = "gpio1";
					};

					config {
						input-enable;
						bias-pull-down;
						drive-strength = <0x02>;
						pins = "gpio1";
					};
				};

				quat_tdm_ws_active {
					phandle = <0x8f>;

					mux {
						function = "func2";
						pins = "gpio1";
					};

					config {
						output-high;
						bias-disable;
						drive-strength = <0x08>;
						pins = "gpio1";
					};
				};
			};

			quat_tdm_sd0 {

				quat_tdm_sd0_sleep {
					phandle = <0x90>;

					mux {
						function = "func2";
						pins = "gpio2";
					};

					config {
						input-enable;
						bias-pull-down;
						drive-strength = <0x02>;
						pins = "gpio2";
					};
				};

				quat_tdm_sd0_active {
					phandle = <0x91>;

					mux {
						function = "func2";
						pins = "gpio2";
					};

					config {
						output-high;
						bias-disable;
						drive-strength = <0x08>;
						pins = "gpio2";
					};
				};
			};

			quat_tdm_sd1 {

				quat_tdm_sd1_sleep {
					phandle = <0x92>;

					mux {
						function = "func2";
						pins = "gpio3";
					};

					config {
						input-enable;
						bias-pull-down;
						drive-strength = <0x02>;
						pins = "gpio3";
					};
				};

				quat_tdm_sd1_active {
					phandle = <0x93>;

					mux {
						function = "func2";
						pins = "gpio3";
					};

					config {
						output-high;
						bias-disable;
						drive-strength = <0x08>;
						pins = "gpio3";
					};
				};
			};

			quat_tdm_sd2 {

				quat_tdm_sd2_sleep {
					phandle = <0x94>;

					mux {
						function = "func2";
						pins = "gpio4";
					};

					config {
						input-enable;
						bias-pull-down;
						drive-strength = <0x02>;
						pins = "gpio4";
					};
				};

				quat_tdm_sd2_active {
					phandle = <0x95>;

					mux {
						function = "func2";
						pins = "gpio4";
					};

					config {
						output-high;
						bias-disable;
						drive-strength = <0x08>;
						pins = "gpio4";
					};
				};
			};

			quat_tdm_sd3 {

				quat_tdm_sd3_sleep {
					phandle = <0x96>;

					mux {
						function = "func3";
						pins = "gpio5";
					};

					config {
						input-enable;
						bias-pull-down;
						drive-strength = <0x02>;
						pins = "gpio5";
					};
				};

				quat_tdm_sd3_active {
					phandle = <0x97>;

					mux {
						function = "func3";
						pins = "gpio5";
					};

					config {
						output-high;
						bias-disable;
						drive-strength = <0x08>;
						pins = "gpio5";
					};
				};
			};

			lpi_tdm1_sck {

				lpi_tdm1_sck_sleep {
					phandle = <0x98>;

					mux {
						function = "func2";
						pins = "gpio6";
					};

					config {
						input-enable;
						bias-pull-down;
						drive-strength = <0x02>;
						pins = "gpio6";
					};
				};

				lpi_tdm1_sck_active {
					phandle = <0x99>;

					mux {
						function = "func2";
						pins = "gpio6";
					};

					config {
						output-high;
						bias-disable;
						drive-strength = <0x08>;
						pins = "gpio6";
					};
				};
			};

			lpi_tdm1_ws {

				lpi_tdm1_ws_sleep {
					phandle = <0x9a>;

					mux {
						function = "func2";
						pins = "gpio7";
					};

					config {
						input-enable;
						bias-pull-down;
						drive-strength = <0x02>;
						pins = "gpio7";
					};
				};

				lpi_tdm1_ws_active {
					phandle = <0x9b>;

					mux {
						function = "func2";
						pins = "gpio7";
					};

					config {
						output-high;
						bias-disable;
						drive-strength = <0x08>;
						pins = "gpio7";
					};
				};
			};

			lpi_tdm1_sd0 {

				lpi_tdm1_sd0_sleep {
					phandle = <0x9c>;

					mux {
						function = "func2";
						pins = "gpio8";
					};

					config {
						input-enable;
						bias-pull-down;
						drive-strength = <0x02>;
						pins = "gpio8";
					};
				};

				lpi_tdm1_sd0_active {
					phandle = <0x9d>;

					mux {
						function = "func2";
						pins = "gpio8";
					};

					config {
						output-high;
						bias-disable;
						drive-strength = <0x08>;
						pins = "gpio8";
					};
				};
			};

			lpi_tdm1_sd1 {

				lpi_tdm1_sd1_sleep {
					phandle = <0x9e>;

					mux {
						function = "func2";
						pins = "gpio9";
					};

					config {
						input-enable;
						bias-pull-down;
						drive-strength = <0x02>;
						pins = "gpio9";
					};
				};

				lpi_tdm1_sd1_active {
					phandle = <0x9f>;

					mux {
						function = "func2";
						pins = "gpio9";
					};

					config {
						output-high;
						bias-disable;
						drive-strength = <0x08>;
						pins = "gpio9";
					};
				};
			};

			lpi_tdm2_sck {

				lpi_tdm2_sck_sleep {
					phandle = <0xa0>;

					mux {
						function = "func2";
						pins = "gpio10";
					};

					config {
						input-enable;
						bias-pull-down;
						drive-strength = <0x02>;
						pins = "gpio10";
					};
				};

				lpi_tdm2_sck_active {
					phandle = <0xa1>;

					mux {
						function = "func2";
						pins = "gpio10";
					};

					config {
						output-high;
						bias-disable;
						drive-strength = <0x08>;
						pins = "gpio10";
					};
				};
			};

			lpi_tdm2_ws {

				lpi_tdm2_ws_sleep {
					phandle = <0xa2>;

					mux {
						function = "func2";
						pins = "gpio11";
					};

					config {
						input-enable;
						bias-pull-down;
						drive-strength = <0x02>;
						pins = "gpio11";
					};
				};

				lpi_tdm2_ws_active {
					phandle = <0xa3>;

					mux {
						function = "func2";
						pins = "gpio11";
					};

					config {
						output-high;
						bias-disable;
						drive-strength = <0x08>;
						pins = "gpio11";
					};
				};
			};

			lpi_tdm2_sd0 {

				lpi_tdm2_sd0_sleep {
					phandle = <0xa4>;

					mux {
						function = "func2";
						pins = "gpio12";
					};

					config {
						input-enable;
						bias-pull-down;
						drive-strength = <0x02>;
						pins = "gpio12";
					};
				};

				lpi_tdm2_sd0_active {
					phandle = <0xa5>;

					mux {
						function = "func2";
						pins = "gpio12";
					};

					config {
						output-high;
						bias-disable;
						drive-strength = <0x08>;
						pins = "gpio12";
					};
				};
			};

			lpi_tdm2_sd1 {

				lpi_tdm2_sd1_sleep {
					phandle = <0xa6>;

					mux {
						function = "func2";
						pins = "gpio13";
					};

					config {
						input-enable;
						bias-pull-down;
						drive-strength = <0x02>;
						pins = "gpio13";
					};
				};

				lpi_tdm2_sd1_active {
					phandle = <0xa7>;

					mux {
						function = "func2";
						pins = "gpio13";
					};

					config {
						output-high;
						bias-disable;
						drive-strength = <0x08>;
						pins = "gpio13";
					};
				};
			};

			lpi_tdm3_sck {

				lpi_tdm3_sck_sleep {
					phandle = <0xa8>;

					mux {
						function = "func1";
						pins = "gpio19";
					};

					config {
						input-enable;
						bias-pull-down;
						drive-strength = <0x02>;
						pins = "gpio19";
					};
				};

				lpi_tdm3_sck_active {
					phandle = <0xa9>;

					mux {
						function = "func1";
						pins = "gpio19";
					};

					config {
						output-high;
						bias-disable;
						drive-strength = <0x08>;
						pins = "gpio19";
					};
				};
			};

			lpi_tdm3_ws {

				lpi_tdm3_ws_sleep {
					phandle = <0xaa>;

					mux {
						function = "func1";
						pins = "gpio20";
					};

					config {
						input-enable;
						bias-pull-down;
						drive-strength = <0x02>;
						pins = "gpio20";
					};
				};

				lpi_tdm3_ws_active {
					phandle = <0xab>;

					mux {
						function = "func1";
						pins = "gpio20";
					};

					config {
						output-high;
						bias-disable;
						drive-strength = <0x08>;
						pins = "gpio20";
					};
				};
			};

			lpi_tdm3_sd0 {

				lpi_tdm3_sd0_sleep {
					phandle = <0xac>;

					mux {
						function = "func1";
						pins = "gpio21";
					};

					config {
						input-enable;
						bias-pull-down;
						drive-strength = <0x02>;
						pins = "gpio21";
					};
				};

				lpi_tdm3_sd0_active {
					phandle = <0xad>;

					mux {
						function = "func1";
						pins = "gpio21";
					};

					config {
						output-high;
						bias-disable;
						drive-strength = <0x08>;
						pins = "gpio21";
					};
				};
			};

			lpi_tdm3_sd1 {

				lpi_tdm3_sd3_sleep {
					phandle = <0xae>;

					mux {
						function = "func1";
						pins = "gpio21";
					};

					config {
						input-enable;
						bias-pull-down;
						drive-strength = <0x02>;
						pins = "gpio21";
					};
				};

				lpi_tdm3_sd1_active {
					phandle = <0xaf>;

					mux {
						function = "func1";
						pins = "gpio21";
					};

					config {
						output-high;
						bias-disable;
						drive-strength = <0x08>;
						pins = "gpio21";
					};
				};
			};

			quat_aux_sck {

				quat_aux_sck_sleep {
					phandle = <0xb0>;

					mux {
						function = "func2";
						pins = "gpio0";
					};

					config {
						input-enable;
						bias-pull-down;
						drive-strength = <0x02>;
						pins = "gpio0";
					};
				};

				quat_aux_sck_active {
					phandle = <0xb1>;

					mux {
						function = "func2";
						pins = "gpio0";
					};

					config {
						output-high;
						bias-disable;
						drive-strength = <0x08>;
						pins = "gpio0";
					};
				};
			};

			quat_aux_ws {

				quat_aux_ws_sleep {
					phandle = <0xb2>;

					mux {
						function = "func2";
						pins = "gpio1";
					};

					config {
						input-enable;
						bias-pull-down;
						drive-strength = <0x02>;
						pins = "gpio1";
					};
				};

				quat_aux_ws_active {
					phandle = <0xb3>;

					mux {
						function = "func2";
						pins = "gpio1";
					};

					config {
						output-high;
						bias-disable;
						drive-strength = <0x08>;
						pins = "gpio1";
					};
				};
			};

			quat_aux_sd0 {

				quat_aux_sd0_sleep {
					phandle = <0xb4>;

					mux {
						function = "func2";
						pins = "gpio2";
					};

					config {
						input-enable;
						bias-pull-down;
						drive-strength = <0x02>;
						pins = "gpio2";
					};
				};

				quat_aux_sd0_active {
					phandle = <0xb5>;

					mux {
						function = "func2";
						pins = "gpio2";
					};

					config {
						output-high;
						bias-disable;
						drive-strength = <0x08>;
						pins = "gpio2";
					};
				};
			};

			quat_aux_sd1 {

				quat_aux_sd1_sleep {
					phandle = <0xb6>;

					mux {
						function = "func2";
						pins = "gpio3";
					};

					config {
						input-enable;
						bias-pull-down;
						drive-strength = <0x02>;
						pins = "gpio3";
					};
				};

				quat_aux_sd1_active {
					phandle = <0xb7>;

					mux {
						function = "func2";
						pins = "gpio3";
					};

					config {
						output-high;
						bias-disable;
						drive-strength = <0x08>;
						pins = "gpio3";
					};
				};
			};

			quat_aux_sd2 {

				quat_aux_sd2_sleep {
					phandle = <0xb8>;

					mux {
						function = "func2";
						pins = "gpio4";
					};

					config {
						input-enable;
						bias-pull-down;
						drive-strength = <0x02>;
						pins = "gpio4";
					};
				};

				quat_aux_sd2_active {
					phandle = <0xb9>;

					mux {
						function = "func2";
						pins = "gpio4";
					};

					config {
						output-high;
						bias-disable;
						drive-strength = <0x08>;
						pins = "gpio4";
					};
				};
			};

			quat_aux_sd3 {

				quat_aux_sd3_sleep {
					phandle = <0xba>;

					mux {
						function = "func2";
						pins = "gpio5";
					};

					config {
						input-enable;
						bias-pull-down;
						drive-strength = <0x02>;
						pins = "gpio5";
					};
				};

				quat_aux_sd3_active {
					phandle = <0xbb>;

					mux {
						function = "func2";
						pins = "gpio5";
					};

					config {
						output-high;
						bias-disable;
						drive-strength = <0x08>;
						pins = "gpio5";
					};
				};
			};

			lpi_aux1_sck {

				lpi_aux1_sck_sleep {
					phandle = <0xbc>;

					mux {
						function = "func2";
						pins = "gpio6";
					};

					config {
						input-enable;
						bias-pull-down;
						drive-strength = <0x02>;
						pins = "gpio6";
					};
				};

				lpi_aux1_sck_active {
					phandle = <0xbd>;

					mux {
						function = "func2";
						pins = "gpio6";
					};

					config {
						output-high;
						bias-disable;
						drive-strength = <0x08>;
						pins = "gpio6";
					};
				};
			};

			lpi_aux1_ws {

				lpi_aux1_ws_sleep {
					phandle = <0xbe>;

					mux {
						function = "func2";
						pins = "gpio7";
					};

					config {
						input-enable;
						bias-pull-down;
						drive-strength = <0x02>;
						pins = "gpio7";
					};
				};

				lpi_aux1_ws_active {
					phandle = <0xbf>;

					mux {
						function = "func2";
						pins = "gpio7";
					};

					config {
						output-high;
						bias-disable;
						drive-strength = <0x08>;
						pins = "gpio7";
					};
				};
			};

			lpi_aux1_sd0 {

				lpi_aux1_sd0_sleep {
					phandle = <0xc0>;

					mux {
						function = "func2";
						pins = "gpio8";
					};

					config {
						input-enable;
						bias-pull-down;
						drive-strength = <0x02>;
						pins = "gpio8";
					};
				};

				lpi_aux1_sd0_active {
					phandle = <0xc1>;

					mux {
						function = "func2";
						pins = "gpio8";
					};

					config {
						output-high;
						bias-disable;
						drive-strength = <0x08>;
						pins = "gpio8";
					};
				};
			};

			lpi_aux1_sd1 {

				lpi_aux1_sd1_sleep {
					phandle = <0xc2>;

					mux {
						function = "func2";
						pins = "gpio9";
					};

					config {
						input-enable;
						bias-pull-down;
						drive-strength = <0x02>;
						pins = "gpio9";
					};
				};

				lpi_aux1_sd1_active {
					phandle = <0xc3>;

					mux {
						function = "func2";
						pins = "gpio9";
					};

					config {
						output-high;
						bias-disable;
						drive-strength = <0x08>;
						pins = "gpio9";
					};
				};
			};

			lpi_aux2_sck {

				lpi_aux2_sck_sleep {
					phandle = <0xc4>;

					mux {
						function = "func2";
						pins = "gpio10";
					};

					config {
						input-enable;
						bias-pull-down;
						drive-strength = <0x02>;
						pins = "gpio10";
					};
				};

				lpi_aux2_sck_active {
					phandle = <0xc5>;

					mux {
						function = "func2";
						pins = "gpio10";
					};

					config {
						output-high;
						bias-disable;
						drive-strength = <0x08>;
						pins = "gpio10";
					};
				};
			};

			lpi_aux2_ws {

				lpi_aux2_ws_sleep {
					phandle = <0xc6>;

					mux {
						function = "func2";
						pins = "gpio11";
					};

					config {
						input-enable;
						bias-pull-down;
						drive-strength = <0x02>;
						pins = "gpio11";
					};
				};

				lpi_aux2_ws_active {
					phandle = <0xc7>;

					mux {
						function = "func2";
						pins = "gpio11";
					};

					config {
						output-high;
						bias-disable;
						drive-strength = <0x08>;
						pins = "gpio11";
					};
				};
			};

			lpi_aux2_sd0 {

				lpi_aux2_sd0_sleep {
					phandle = <0xc8>;

					mux {
						function = "func2";
						pins = "gpio12";
					};

					config {
						input-enable;
						bias-pull-down;
						drive-strength = <0x02>;
						pins = "gpio12";
					};
				};

				lpi_aux2_sd0_active {
					phandle = <0xc9>;

					mux {
						function = "func2";
						pins = "gpio12";
					};

					config {
						output-high;
						bias-disable;
						drive-strength = <0x08>;
						pins = "gpio12";
					};
				};
			};

			lpi_aux2_sd1 {

				lpi_aux2_sd1_sleep {
					phandle = <0xca>;

					mux {
						function = "func2";
						pins = "gpio13";
					};

					config {
						input-enable;
						bias-pull-down;
						drive-strength = <0x02>;
						pins = "gpio13";
					};
				};

				lpi_aux2_sd1_active {
					phandle = <0xcb>;

					mux {
						function = "func2";
						pins = "gpio13";
					};

					config {
						output-high;
						bias-disable;
						drive-strength = <0x08>;
						pins = "gpio13";
					};
				};
			};

			lpi_aux3_sck {

				lpi_aux3_sck_sleep {
					phandle = <0xcc>;

					mux {
						function = "func1";
						pins = "gpio19";
					};

					config {
						input-enable;
						bias-pull-down;
						drive-strength = <0x02>;
						pins = "gpio19";
					};
				};

				lpi_aux3_sck_active {
					phandle = <0xcd>;

					mux {
						function = "func1";
						pins = "gpio19";
					};

					config {
						output-high;
						bias-disable;
						drive-strength = <0x08>;
						pins = "gpio19";
					};
				};
			};

			lpi_aux3_ws {

				lpi_aux3_ws_sleep {
					phandle = <0xce>;

					mux {
						function = "func1";
						pins = "gpio20";
					};

					config {
						input-enable;
						bias-pull-down;
						drive-strength = <0x02>;
						pins = "gpio20";
					};
				};

				lpi_aux3_ws_active {
					phandle = <0xcf>;

					mux {
						function = "func1";
						pins = "gpio20";
					};

					config {
						output-high;
						bias-disable;
						drive-strength = <0x08>;
						pins = "gpio20";
					};
				};
			};

			lpi_aux3_sd0 {

				lpi_aux3_sd0_sleep {
					phandle = <0xd0>;

					mux {
						function = "func1";
						pins = "gpio21";
					};

					config {
						input-enable;
						bias-pull-down;
						drive-strength = <0x02>;
						pins = "gpio21";
					};
				};

				lpi_aux3_sd0_active {
					phandle = <0xd1>;

					mux {
						function = "func1";
						pins = "gpio21";
					};

					config {
						output-high;
						bias-disable;
						drive-strength = <0x08>;
						pins = "gpio21";
					};
				};
			};

			lpi_aux3_sd1 {

				lpi_aux3_sd1_sleep {
					phandle = <0xd2>;

					mux {
						function = "func1";
						pins = "gpio22";
					};

					config {
						input-enable;
						bias-pull-down;
						drive-strength = <0x02>;
						pins = "gpio22";
					};
				};

				lpi_aux3_sd1_active {
					phandle = <0xd3>;

					mux {
						function = "func1";
						pins = "gpio22";
					};

					config {
						output-high;
						bias-disable;
						drive-strength = <0x08>;
						pins = "gpio22";
					};
				};
			};

			bt_swr_clk_pin {

				bt_swr_clk_sleep {
					phandle = <0x8c>;

					mux {
						function = "func3";
						pins = "gpio19";
					};

					config {
						bias-pull-down;
						input-enable;
						drive-strength = <0x02>;
						pins = "gpio19";
					};
				};

				bt_swr_clk_active {
					phandle = <0x8a>;

					mux {
						function = "func3";
						pins = "gpio19";
					};

					config {
						bias-disable;
						slew-rate = <0x01>;
						drive-strength = <0x02>;
						pins = "gpio19";
					};
				};
			};

			bt_swr_data_pin {

				bt_swr_data_sleep {
					phandle = <0x8d>;

					mux {
						function = "func3";
						pins = "gpio20";
					};

					config {
						bias-pull-down;
						input-enable;
						drive-strength = <0x02>;
						pins = "gpio20";
					};
				};

				bt_swr_data_active {
					phandle = <0x8b>;

					mux {
						function = "func3";
						pins = "gpio20";
					};

					config {
						bias-bus-hold;
						slew-rate = <0x01>;
						drive-strength = <0x02>;
						pins = "gpio20";
					};
				};
			};

			tx_swr_clk_active {
				phandle = <0x72>;

				mux {
					function = "func1";
					pins = "gpio0";
				};

				config {
					bias-disable;
					slew-rate = <0x01>;
					drive-strength = <0x04>;
					pins = "gpio0";
				};
			};

			tx_swr_clk_sleep {
				phandle = <0x76>;

				mux {
					bias-pull-down;
					input-enable;
					function = "func1";
					pins = "gpio0";
				};

				config {
					drive-strength = <0x02>;
					pins = "gpio0";
				};
			};

			tx_swr_data0_active {
				phandle = <0x73>;

				mux {
					function = "func1";
					pins = "gpio1";
				};

				config {
					bias-bus-hold;
					slew-rate = <0x01>;
					drive-strength = <0x04>;
					pins = "gpio1";
				};
			};

			tx_swr_data0_sleep {
				phandle = <0x77>;

				mux {
					function = "func1";
					pins = "gpio1";
				};

				config {
					bias-pull-down;
					input-enable;
					drive-strength = <0x02>;
					pins = "gpio1";
				};
			};

			tx_swr_data1_active {
				phandle = <0x74>;

				mux {
					function = "func1";
					pins = "gpio2";
				};

				config {
					bias-bus-hold;
					slew-rate = <0x01>;
					drive-strength = <0x04>;
					pins = "gpio2";
				};
			};

			tx_swr_data1_sleep {
				phandle = <0x78>;

				mux {
					function = "func1";
					pins = "gpio2";
				};

				config {
					bias-pull-down;
					input-enable;
					drive-strength = <0x02>;
					pins = "gpio2";
				};
			};

			tx_swr_data2_active {
				phandle = <0x75>;

				mux {
					function = "func1";
					pins = "gpio14";
				};

				config {
					bias-bus-hold;
					slew-rate = <0x01>;
					drive-strength = <0x04>;
					pins = "gpio14";
				};
			};

			tx_swr_data2_sleep {
				phandle = <0x79>;

				mux {
					function = "func1";
					pins = "gpio14";
				};

				config {
					bias-pull-down;
					input-enable;
					drive-strength = <0x02>;
					pins = "gpio14";
				};
			};

			rx_swr_clk_active {
				phandle = <0x6c>;

				mux {
					function = "func1";
					pins = "gpio3";
				};

				config {
					bias-disable;
					slew-rate = <0x01>;
					drive-strength = <0x02>;
					pins = "gpio3";
				};
			};

			rx_swr_clk_sleep {
				phandle = <0x6f>;

				mux {
					function = "func1";
					pins = "gpio3";
				};

				config {
					bias-pull-down;
					input-enable;
					drive-strength = <0x02>;
					pins = "gpio3";
				};
			};

			rx_swr_data_active {
				phandle = <0x6d>;

				mux {
					function = "func1";
					pins = "gpio4";
				};

				config {
					bias-bus-hold;
					slew-rate = <0x01>;
					drive-strength = <0x02>;
					pins = "gpio4";
				};
			};

			rx_swr_data_sleep {
				phandle = <0x70>;

				mux {
					function = "func1";
					pins = "gpio4";
				};

				config {
					bias-pull-down;
					input-enable;
					drive-strength = <0x02>;
					pins = "gpio4";
				};
			};

			rx_swr_data1_active {
				phandle = <0x6e>;

				mux {
					function = "func1";
					pins = "gpio5";
				};

				config {
					bias-bus-hold;
					slew-rate = <0x01>;
					drive-strength = <0x02>;
					pins = "gpio5";
				};
			};

			rx_swr_data1_sleep {
				phandle = <0x71>;

				mux {
					function = "func1";
					pins = "gpio5";
				};

				config {
					bias-pull-down;
					input-enable;
					drive-strength = <0x02>;
					pins = "gpio5";
				};
			};

			dmic01_clk_active {
				phandle = <0x7a>;

				mux {
					function = "func1";
					pins = "gpio6";
				};

				config {
					output-high;
					drive-strength = <0x08>;
					pins = "gpio6";
				};
			};

			dmic01_clk_sleep {
				phandle = <0x7c>;

				mux {
					function = "func1";
					pins = "gpio6";
				};

				config {
					output-low;
					bias-disable;
					drive-strength = <0x02>;
					pins = "gpio6";
				};
			};

			dmic01_data_active {
				phandle = <0x7b>;

				mux {
					function = "func1";
					pins = "gpio7";
				};

				config {
					input-enable;
					drive-strength = <0x08>;
					pins = "gpio7";
				};
			};

			dmic01_data_sleep {
				phandle = <0x7d>;

				mux {
					function = "func1";
					pins = "gpio7";
				};

				config {
					input-enable;
					pull-down;
					drive-strength = <0x02>;
					pins = "gpio7";
				};
			};

			dmic23_clk_active {
				phandle = <0x7e>;

				mux {
					function = "func1";
					pins = "gpio8";
				};

				config {
					output-high;
					drive-strength = <0x08>;
					pins = "gpio8";
				};
			};

			dmic23_clk_sleep {
				phandle = <0x80>;

				mux {
					function = "func1";
					pins = "gpio8";
				};

				config {
					output-low;
					bias-disable;
					drive-strength = <0x02>;
					pins = "gpio8";
				};
			};

			dmic23_data_active {
				phandle = <0x7f>;

				mux {
					function = "func1";
					pins = "gpio9";
				};

				config {
					input-enable;
					drive-strength = <0x08>;
					pins = "gpio9";
				};
			};

			dmic23_data_sleep {
				phandle = <0x81>;

				mux {
					function = "func1";
					pins = "gpio9";
				};

				config {
					input-enable;
					pull-down;
					drive-strength = <0x02>;
					pins = "gpio9";
				};
			};

			cdc_dmic45_clk_active {
				phandle = <0x82>;

				mux {
					function = "func1";
					pins = "gpio12";
				};

				config {
					input-enable;
					drive-strength = <0x08>;
					pins = "gpio12";
				};
			};

			lpi_dmic45_clk_sleep {
				phandle = <0x84>;

				mux {
					function = "func1";
					pins = "gpio12";
				};

				config {
					input-enable;
					pull-down;
					drive-strength = <0x02>;
					pins = "gpio12";
				};
			};

			cdc_dmic45_data_active {
				phandle = <0x83>;

				mux {
					function = "func1";
					pins = "gpio13";
				};

				config {
					input-enable;
					drive-strength = <0x08>;
					pins = "gpio13";
				};
			};

			cdc_dmic45_data_sleep {
				phandle = <0x85>;

				mux {
					function = "func1";
					pins = "gpio13";
				};

				config {
					input-enable;
					pull-down;
					drive-strength = <0x02>;
					pins = "gpio13";
				};
			};

			cdc_dmic67_clk_active {
				phandle = <0x86>;

				mux {
					function = "func2";
					pins = "gpio21";
				};

				config {
					input-enable;
					drive-strength = <0x08>;
					pins = "gpio21";
				};
			};

			lpi_dmic67_clk_sleep {
				phandle = <0x88>;

				mux {
					function = "func2";
					pins = "gpio21";
				};

				config {
					input-enable;
					pull-down;
					drive-strength = <0x02>;
					pins = "gpio21";
				};
			};

			cdc_dmic67_data_active {
				phandle = <0x87>;

				mux {
					function = "func2";
					pins = "gpio22";
				};

				config {
					input-enable;
					drive-strength = <0x08>;
					pins = "gpio22";
				};
			};

			cdc_dmic67_data_sleep {
				phandle = <0x89>;

				mux {
					function = "func2";
					pins = "gpio22";
				};

				config {
					input-enable;
					pull-down;
					drive-strength = <0x02>;
					pins = "gpio22";
				};
			};

			wsa_swr_clk_pin {

				wsa_swr_clk_sleep {
					phandle = <0x6a>;

					mux {
						function = "func1";
						pins = "gpio10";
					};

					config {
						bias-pull-down;
						input-enable;
						drive-strength = <0x02>;
						pins = "gpio10";
					};
				};

				wsa_swr_clk_active {
					phandle = <0x68>;

					mux {
						function = "func1";
						pins = "gpio10";
					};

					config {
						bias-disable;
						slew-rate = <0x01>;
						drive-strength = <0x02>;
						pins = "gpio10";
					};
				};
			};

			wsa_swr_data_pin {

				wsa_swr_data_active {
					phandle = <0x69>;

					mux {
						function = "func1";
						pins = "gpio11";
					};

					config {
						bias-bus-hold;
						slew-rate = <0x01>;
						drive-strength = <0x02>;
						pins = "gpio11";
					};
				};

				wsa_swr_data_sleep {
					phandle = <0x6b>;

					mux {
						function = "func1";
						pins = "gpio11";
					};

					config {
						bias-pull-down;
						input-enable;
						drive-strength = <0x02>;
						pins = "gpio11";
					};
				};
			};
		};
	};

	fragment@21 {
		target = <0xffffffff>;

		__overlay__ {
			#size-cells = <0x01>;
			#address-cells = <0x01>;
			qcom,lpass-cdc-version = <0x07>;
			qcom,num-macros = <0x03>;

			lpass-cdc-clk-rsc-mngr {
				clocks = <0x26 0x00 0x27 0x00 0x28 0x00 0x29 0x00>;
				clock-names = "tx_core_clk", "rx_core_clk", "rx_tx_core_clk", "va_core_clk";
				qcom,wsa_mclk_mode_muxsel = <0x6bea110>;
				qcom,rx_mclk_mode_muxsel = <0x6bec0d8>;
				qcom,fs-gen-sequence = <0x3000 0x01 0x01 0x3004 0x03 0x03 0x3004 0x03 0x01 0x3080 0x02 0x02>;
				compatible = "qcom,lpass-cdc-clk-rsc-mngr";
			};

			va-macro@7660000 {
				phandle = <0xd4>;
				reg = <0x7660000 0x00>;
				qcom,va-swr-gpios = <0x2a>;
				qcom,is-used-swr-gpio = <0x01>;
				qcom,use-clk-id = <0x03>;
				qcom,default-clk-id = <0x00>;
				qcom,va-clk-mux-select = <0x01>;
				qcom,va-dmic-sample-rate = <0x927c0>;
				clocks = <0xffffffff 0x00>;
				clock-names = "lpass_audio_hw_vote";
				compatible = "qcom,lpass-cdc-va-macro";

				va_swr_master {
					phandle = <0xd5>;
					swrm-io-base = <0x7630000 0x00>;
					qcom,is-always-on = <0x01>;
					qcom,swr-mstr-irq-wakeup-capable = <0x01>;
					qcom,swr-clock-stop-mode0 = <0x01>;
					qcom,swr-num-dev = <0x05>;
					qcom,swr-port-mapping = <0x01 0x2d 0x03 0x02 0x2e 0x01 0x02 0x2f 0x02 0x02 0x30 0x04 0x02 0x31 0x08 0x03 0x32 0x01 0x03 0x33 0x02 0x03 0x34 0x04 0x03 0x35 0x08 0x04 0x36 0x01 0x04 0x37 0x02 0x04 0x38 0x04 0x04 0x39 0x08 0x05 0x3a 0x03>;
					qcom,swr-num-ports = <0x05>;
					qcom,swr-wakeup-required = <0x01>;
					interrupt-names = "swr_master_irq", "swr_wake_irq";
					interrupts = <0x00 0x2d1 0x04 0x00 0x208 0x04>;
					qcom,mipi-sdw-block-packing-mode = <0x01>;
					qcom,swr_master_id = <0x03>;
					clocks = <0xffffffff 0x00 0xffffffff 0x00>;
					clock-names = "lpass_core_hw_vote", "lpass_audio_hw_vote";
					#size-cells = <0x00>;
					#address-cells = <0x02>;
					compatible = "qcom,swr-mstr";

					wcd9378-tx-slave {
						phandle = <0x35>;
						status = "okay";
						reg = <0x10 0x1170223>;
						compatible = "qcom,wcd9378-slave";
					};

					wcd939x-tx-slave {
						phandle = <0x33>;
						reg = <0x0e 0x1170223>;
						compatible = "qcom,wcd939x-slave";
						status = "disabled";
					};
				};
			};

			tx-macro@6AE0000 {
				phandle = <0xd6>;
				reg = <0x6ae0000 0x00>;
				qcom,is-used-swr-gpio = <0x00>;
				qcom,tx-dmic-sample-rate = <0x249f00>;
				qcom,default-clk-id = <0x00>;
				compatible = "qcom,lpass-cdc-tx-macro";
			};

			rx-macro@6AC0000 {
				phandle = <0xd7>;
				reg = <0x6ac0000 0x00>;
				clocks = <0x2c 0x00>;
				clock-names = "rx_mclk2_2x_clk";
				qcom,default-clk-id = <0x05>;
				qcom,rx-bcl-pmic-params = [00 03 48];
				qcom,rx_mclk_mode_muxsel = <0x6bec0d8>;
				qcom,rx-swr-gpios = <0x2b>;
				compatible = "qcom,lpass-cdc-rx-macro";

				rx_swr_master {
					phandle = <0xd8>;
					interrupts = <0x00 0x9b 0x04>;
					swrm-io-base = <0x6ad0000 0x00>;
					qcom,swr-clock-stop-mode0 = <0x01>;
					qcom,swr-num-dev = <0x02>;
					qcom,swr-port-mapping = <0x01 0x0e 0x01 0x01 0x0f 0x02 0x02 0x12 0x03 0x03 0x10 0x01 0x03 0x11 0x02 0x04 0x13 0x01 0x05 0x14 0x01 0x05 0x15 0x02 0x06 0x16 0x01 0x07 0x17 0x03 0x08 0x18 0x03 0x09 0x3b 0x01 0x09 0x3c 0x02 0x0a 0x1a 0x03 0x0b 0x1b 0x03 0x0c 0x1c 0x03>;
					qcom,swr-num-ports = <0x0c>;
					interrupt-names = "swr_master_irq";
					qcom,mipi-sdw-block-packing-mode = <0x01>;
					qcom,swr_master_id = <0x02>;
					clocks = <0xffffffff 0x00 0xffffffff 0x00>;
					clock-names = "lpass_core_hw_vote", "lpass_audio_hw_vote";
					#size-cells = <0x00>;
					#address-cells = <0x02>;
					compatible = "qcom,swr-mstr";

					swr_haptics@f0170220 {
						phandle = <0xd9>;
						status = "disabled";
						qcom,rx_swr_ch_map = <0x00 0x01 0x01 0x00 0x16>;
						reg = <0x03 0xf0170220>;
						compatible = "qcom,pmih010x-swr-haptics";
					};

					wcd9378-rx-slave {
						phandle = <0x34>;
						status = "okay";
						reg = <0x10 0x1170224>;
						compatible = "qcom,wcd9378-slave";
					};

					wcd939x-rx-slave {
						phandle = <0x32>;
						status = "disabled";
						reg = <0x0e 0x1170224>;
						compatible = "qcom,wcd939x-slave";
					};
				};
			};

			wsa-macro@6B00000 {
				phandle = <0x2f>;
				reg = <0x6b00000 0x00>;
				#cooling-cells = <0x02>;
				qcom,noise-gate-mode = <0x02>;
				qcom,thermal-max-state = <0x0b>;
				qcom,default-clk-id = <0x06>;
				qcom,wsa-bcl-pmic-params = [00 03 48];
				qcom,wsa-system-gains = <0x00 0x09 0x00 0x09>;
				qcom,wsa-rloads = <0x02 0x02>;
				qcom,wsa-bat-cfgs = <0x01 0x01>;
				qcom,wsa-swr-gpios = <0x2d>;
				wsa_data_fs_ctl_reg = <0x6b6f000>;
				compatible = "qcom,lpass-cdc-wsa-macro";
				status = "disabled";

				wsa_swr_master {
					phandle = <0xda>;
					interrupts = <0x00 0xaa 0x04>;
					swrm-io-base = <0x6b10000 0x00>;
					qcom,dynamic-port-map-supported = <0x00>;
					qcom,swr-num-dev = <0x02>;
					qcom,swr-port-mapping = <0x01 0x01 0x01 0x02 0x02 0x0f 0x03 0x03 0x03 0x04 0x04 0x01 0x05 0x05 0x0f 0x06 0x06 0x03 0x07 0x07 0x03 0x08 0x08 0x03 0x09 0x09 0x03 0x0a 0x0a 0x03 0x0b 0x0b 0x03 0x0c 0x0c 0x03 0x0d 0x0d 0x03>;
					qcom,swr-clock-stop-mode0 = <0x01>;
					qcom,swr-num-ports = <0x0d>;
					interrupt-names = "swr_master_irq";
					qcom,mipi-sdw-block-packing-mode = <0x00>;
					qcom,swr_master_id = <0x01>;
					clocks = <0xffffffff 0x00 0xffffffff 0x00>;
					clock-names = "lpass_core_hw_vote", "lpass_audio_hw_vote";
					#size-cells = <0x00>;
					#address-cells = <0x02>;
					compatible = "qcom,swr-mstr";

					wsa884x@02170220 {
						phandle = <0x3a>;
						sound-name-prefix = "SpkrLeft";
						qcom,cdc-static-supplies = "cdc-vdd-1p8";
						qcom,cdc-vdd-1p8-lpm-supported = <0x01>;
						qcom,cdc-vdd-1p8-current = <0x4e20>;
						qcom,cdc-vdd-1p8-voltage = <0x1b7740 0x1b7740>;
						cdc-vdd-1p8-supply = <0xffffffff>;
						qcom,swr-wsa-port-params = <0x01 0x00 0x03 0x00 0x05 0x00 0x00 0x00 0x06 0x00 0x00 0x00 0x01 0x00 0x03 0x00 0x05 0x00 0x00 0x00 0x06 0x00 0x00 0x00 0x01 0x00 0x03 0x00 0x05 0x00 0x00 0x00 0x06 0x00 0x00 0x00 0x01 0x00 0x03 0x00 0x05 0x00 0x00 0x00 0x06 0x00 0x00 0x00>;
						qcom,wsa-macro-handle = <0x2f>;
						qcom,lpass-cdc-handle = <0xffffffff>;
						qcom,spkr-sd-n-node = <0x2e>;
						reg = <0x04 0x2170220>;
						status = "okay";
						compatible = "qcom,wsa884x";
					};

					wsa884x@02170221 {
						phandle = <0x3b>;
						status = "okay";
						sound-name-prefix = "SpkrRight";
						qcom,cdc-static-supplies = "cdc-vdd-1p8";
						qcom,cdc-vdd-1p8-lpm-supported = <0x01>;
						qcom,cdc-vdd-1p8-current = <0x4e20>;
						qcom,cdc-vdd-1p8-voltage = <0x1b7740 0x1b7740>;
						cdc-vdd-1p8-supply = <0xffffffff>;
						qcom,swr-wsa-port-params = <0x02 0x00 0x04 0x00 0x15 0x00 0x09 0x00 0x0d 0x00 0x19 0x00 0x02 0x00 0x04 0x00 0x15 0x00 0x09 0x00 0x0d 0x00 0x19 0x00 0x02 0x00 0x04 0x00 0x15 0x00 0x09 0x00 0x0d 0x00 0x19 0x00 0x02 0x00 0x04 0x00 0x15 0x00 0x09 0x00 0x0d 0x00 0x19 0x00>;
						qcom,wsa-macro-handle = <0x2f>;
						qcom,lpass-cdc-handle = <0xffffffff>;
						qcom,spkr-sd-n-node = <0x30>;
						reg = <0x04 0x2170221>;
						compatible = "qcom,wsa884x";
					};
				};
			};

			wcd939x-codec {
				phandle = <0xdb>;
				qcom,cdc-on-demand-supplies = "cdc-vdd-buck", "cdc-vdd-px";
				qcom,cdc-static-supplies = "cdc-vdd-rx", "cdc-vdd-tx", "cdc-vdd-mic-bias";
				qcom,cdc-micbias4-mv = <0x708>;
				qcom,cdc-micbias3-mv = <0x708>;
				qcom,cdc-micbias2-mv = <0x708>;
				qcom,cdc-micbias1-mv = <0x708>;
				qcom,cdc-vdd-px-rem-supported = <0x01>;
				qcom,cdc-vdd-px-lpm-supported = <0x01>;
				qcom,cdc-vdd-px-current = <0x3a98>;
				qcom,cdc-vdd-px-voltage = <0x124f80 0x124f80>;
				cdc-vdd-px-supply = <0xffffffff>;
				qcom,cdc-vdd-mic-bias-current = <0x7530>;
				qcom,cdc-vdd-mic-bias-voltage = "", "2K", "", "2K";
				cdc-vdd-mic-bias-supply = <0xffffffff>;
				qcom,cdc-vdd-buck-lpm-supported = <0x01>;
				qcom,cdc-vdd-buck-current = <0x9eb10>;
				qcom,cdc-vdd-buck-voltage = <0x1b7740 0x1b7740>;
				cdc-vdd-buck-supply = <0xffffffff>;
				qcom,cdc-vdd-tx-lpm-supported = <0x01>;
				qcom,cdc-vdd-tx-current = <0xafc8>;
				qcom,cdc-vdd-tx-voltage = <0x1b7740 0x1b7740>;
				cdc-vdd-tx-supply = <0xffffffff>;
				qcom,cdc-vdd-rx-lpm-supported = <0x01>;
				qcom,cdc-vdd-rx-current = <0xafc8>;
				qcom,cdc-vdd-rx-voltage = <0x1b7740 0x1b7740>;
				cdc-vdd-rx-supply = <0xffffffff>;
				qcom,tx-slave = <0x33>;
				qcom,rx-slave = <0x32>;
				qcom,wcd-rst-gpio-node = <0x31>;
				qcom,swr-tx-port-params = <0x00 0x01 0x00 0x02 0x01 0x00 0x01 0x00 0x00 0x01 0x01 0x00 0x01 0x00 0x01 0x00 0x00 0x01 0x02 0x00 0x01 0x00 0x02 0x00 0x01 0x00 0x01 0x00 0x01 0x00 0x01 0x00>;
				qcom,tx_swr_ch_map = <0x00 0x1e 0x01 0x00 0x2e 0x00 0x1f 0x02 0x00 0x2f 0x01 0x20 0x01 0x00 0x30 0x01 0x21 0x02 0x00 0x31 0x02 0x22 0x01 0x00 0x32 0x02 0x23 0x02 0x00 0x33 0x02 0x1d 0x04 0x00 0x34 0x02 0x24 0x04 0x00 0x34 0x02 0x25 0x08 0x00 0x35 0x03 0x26 0x01 0x00 0x36 0x03 0x27 0x02 0x00 0x37 0x03 0x28 0x04 0x00 0x38 0x03 0x29 0x08 0x00 0x39>;
				qcom,rx_swr_ch_map = <0x00 0x0e 0x01 0x00 0x0e 0x00 0x0f 0x02 0x00 0x0f 0x01 0x12 0x01 0x00 0x12 0x02 0x10 0x01 0x00 0x10 0x02 0x11 0x02 0x00 0x11 0x03 0x13 0x01 0x00 0x13 0x04 0x14 0x01 0x00 0x14 0x04 0x15 0x02 0x00 0x15 0x05 0x3b 0x01 0x00 0x3b 0x05 0x3c 0x02 0x00 0x3c>;
				qcom,split-codec = <0x01>;
				status = "disabled";
				compatible = "qcom,wcd939x-codec";

				qcom,wcd-mb1-reg {
					phandle = <0xdc>;
					regulator-name = "wcd-mb1-reg";
				};

				qcom,wcd-mb2-reg {
					phandle = <0xdd>;
					regulator-name = "wcd-mb2-reg";
				};

				qcom,wcd-mb3-reg {
					phandle = <0xde>;
					regulator-name = "wcd-mb3-reg";
				};

				qcom,wcd-mb4-reg {
					phandle = <0xdf>;
					regulator-name = "wcd-mb4-reg";
				};
			};

			wcd9378-codec {
				phandle = <0x39>;
				status = "okay";
				qcom,cdc-on-demand-supplies = "cdc-vdd-buck";
				qcom,cdc-static-supplies = "cdc-vdd-rxtx", "cdc-vdd-io";
				qcom,cdc-micbias3-mv = <0x708>;
				qcom,cdc-micbias2-mv = <0x708>;
				qcom,cdc-micbias1-mv = <0x708>;
				qcom,cdc-vdd-mic-bias-current = <0x9e66>;
				qcom,cdc-vdd-mic-bias-voltage = <0x325aa0 0x325aa0>;
				cdc-vdd-mic-bias-supply = <0xffffffff>;
				qcom,cdc-vdd-buck-lpm-supported = <0x01>;
				qcom,cdc-vdd-buck-current = <0x7576>;
				qcom,cdc-vdd-buck-voltage = <0x1b7740 0x1b7740>;
				cdc-vdd-buck-supply = <0xffffffff>;
				qcom,cdc-vdd-io-lpm-supported = <0x01>;
				qcom,cdc-vdd-io-current = <0x4e20>;
				qcom,cdc-vdd-io-voltage = <0x1b7740 0x1b7740>;
				cdc-vdd-io-supply = <0xffffffff>;
				qcom,cdc-vdd-rxtx-lpm-supported = <0x01>;
				qcom,cdc-vdd-rxtx-current = <0x7530>;
				qcom,cdc-vdd-rxtx-voltage = <0x1b7740 0x1b7740>;
				cdc-vdd-rxtx-supply = <0xffffffff>;
				qcom,tx-slave = <0x35>;
				qcom,rx-slave = <0x34>;
				qcom,wcd-rst-gpio-node = <0x31>;
				qcom,swr-tx-port-params = <0x01 0x00 0x01 0x01 0x00 0x01 0x01 0x00 0x00 0x01 0x01 0x00 0x01 0x00 0x01 0x00 0x00 0x01 0x02 0x00 0x01 0x00 0x02 0x00 0x01 0x00 0x01 0x00 0x01 0x00 0x01 0x00>;
				qcom,tx_swr_ch_map = <0x00 0x1e 0x01 0x00 0x2e 0x01 0x1f 0x01 0x00 0x2f 0x02 0x20 0x01 0x00 0x30 0x03 0x22 0x04 0x00 0x32 0x03 0x23 0x08 0x00 0x33 0x03 0x1d 0x01 0x00 0x34 0x04 0x24 0x01 0x00 0x34 0x04 0x25 0x02 0x00 0x35 0x04 0x26 0x03 0x00 0x36 0x04 0x27 0x04 0x00 0x37>;
				qcom,rx_swr_ch_map = <0x00 0x0e 0x01 0x00 0x0e 0x00 0x0f 0x02 0x00 0x0f 0x01 0x12 0x01 0x00 0x12 0x02 0x10 0x01 0x00 0x10 0x02 0x11 0x02 0x00 0x11 0x03 0x13 0x01 0x00 0x13 0x04 0x14 0x01 0x00 0x14 0x04 0x15 0x02 0x00 0x15>;
				qcom,wcd-mode = <0x01>;
				qcom,split-codec = <0x01>;
				compatible = "qcom,wcd9378-codec";
			};
		};
	};

	fragment@22 {
		target = <0xffffffff>;

		__overlay__ {
			qcom,bt-swr-gpios = <0x38>;
			clocks = <0x36 0x00 0x37 0x00 0xffffffff 0x00 0xffffffff 0x00>;
			clock-names = "bt_swr_mclk_clk", "bt_swr_mclk_clk_2x", "lpass_core_hw_vote", "lpass_audio_hw_vote";
		};
	};

	fragment@23 {
		target = <0xffffffff>;

		__overlay__ {
			qcom,swr-num-dev = <0x01>;
			qcom,swr-port-mapping = <0x01 0x65 0x03 0x02 0x67 0x03 0x03 0x69 0x03 0x05 0x66 0x03 0x06 0x68 0x03 0x07 0x6a 0x03 0x08 0x6b 0x03>;
			qcom,swr-num-ports = <0x07>;
			interrupt-names = "swr_master_irq";
			interrupts = <0x00 0x8a 0x04>;
			swrm-io-base = <0x6ca0000 0x00>;
			clocks = <0xffffffff 0x00 0xffffffff 0x00>;
			clock-names = "lpass_core_hw_vote", "lpass_audio_hw_vote";
			qcom,swr_master_id = <0x05>;
			compatible = "qcom,swr-mstr";
		};
	};

	fragment@24 {
		target = <0xffffffff>;

		__overlay__ {

			sound {
				phandle = <0xe0>;
				qcom,msm-mbhc-hs-mic-max-threshold-mv = <0x690>;
				qcom,cdc-dmic67-gpios = <0x43>;
				qcom,sep-mi2s-gpios = <0x42>;
				qcom,sen-mi2s-gpios = <0x41>;
				qcom,quin-mi2s-gpios = <0x40>;
				qcom,quat-mi2s-gpios = <0x3f>;
				qcom,pri-mi2s-gpios = <0x3e>;
				qcom,msm_audio_ssr_devs = <0xffffffff 0xffffffff 0xffffffff>;
				qcom,cdc-dmic23-gpios = <0x3d>;
				qcom,cdc-dmic01-gpios = <0x3c>;
				qcom,wsa-max-devs = <0x02>;
				qcom,msm-mbhc-gnd-swh = <0x01>;
				qcom,msm-mbhc-hphl-swh = <0x01>;
				qcom,msm-mbhc-usbc-audio-supported = <0x00>;
				asoc-codec-names = "msm-stub-codec.1", "lpass-cdc", "wcd9378_codec", "wsa-codec1", "wsa-codec2";
				asoc-codec = <0xffffffff 0xffffffff 0x39 0x3a 0x3b>;
				qcom,audio-routing = "AMIC1", "Analog Mic1", "AMIC1", "MIC BIAS1", "AMIC2", "Analog Mic2", "AMIC2", "MIC BIAS2", "AMIC3", "Analog Mic3", "AMIC3", "MIC BIAS3", "AMIC4", "Analog Mic4", "VA AMIC1", "Analog Mic1", "VA AMIC1", "VA MIC BIAS1", "VA AMIC2", "Analog Mic2", "VA AMIC2", "VA MIC BIAS2", "VA AMIC3", "Analog Mic3", "VA AMIC3", "VA MIC BIAS3", "VA AMIC4", "Analog Mic4", "TX DMIC0", "Digital Mic0", "TX DMIC0", "MIC BIAS3", "TX DMIC1", "Digital Mic1", "TX DMIC1", "MIC BIAS3", "TX DMIC2", "Digital Mic2", "TX DMIC2", "MIC BIAS1", "TX DMIC3", "Digital Mic3", "TX DMIC3", "MIC BIAS1", "TX DMIC6", "Digital Mic6", "TX DMIC6", "MIC BIAS1", "TX DMIC7", "Digital Mic7", "TX DMIC7", "MIC BIAS1", "IN1_HPHL", "HPHL_OUT", "IN2_HPHR", "HPHR_OUT", "IN3_AUX", "AUX_OUT", "WSA SRC0_INP", "SRC0", "WSA_TX DEC0_INP", "TX DEC0 MUX", "WSA_TX DEC1_INP", "TX DEC1 MUX", "RX_TX DEC0_INP", "TX DEC0 MUX", "RX_TX DEC1_INP", "TX DEC1 MUX", "RX_TX DEC2_INP", "TX DEC2 MUX", "RX_TX DEC3_INP", "TX DEC3 MUX", "SpkrLeft IN", "WSA_SPK1 OUT", "SpkrRight IN", "WSA_SPK2 OUT", "VA SWR_INPUT", "VA_SWR_CLK", "VA_AIF1 CAP", "VA_SWR_CLK", "VA_AIF2 CAP", "VA_SWR_CLK", "VA_AIF3 CAP", "VA_SWR_CLK", "VA DMIC0", "Digital Mic0", "VA DMIC1", "Digital Mic1", "VA DMIC2", "Digital Mic2", "VA DMIC3", "Digital Mic3", "VA DMIC6", "Digital Mic6", "VA DMIC7", "Digital Mic7", "VA DMIC0", "VA MIC BIAS3", "VA DMIC1", "VA MIC BIAS3", "VA DMIC2", "VA MIC BIAS1", "VA DMIC3", "VA MIC BIAS1", "VA DMIC6", "VA MIC BIAS1", "VA DMIC7", "VA MIC BIAS1";
				qcom,audio-core-list = <0x00 0x01>;
				qcom,mi2s-clk-attribute = <0x01 0x01 0x01 0x01 0x01 0x01 0x01>;
				qcom,tdm-clk-attribute = <0x01 0x01 0x01 0x01 0x01 0x01 0x01>;
				qcom,tdm-max-slots = <0x08>;
				qcom,ext-disp-audio-rx = <0x01>;
				swr-haptics-unsupported;
				qcom,wcn-bt = <0x01>;
				qcom,mi2s-tdm-is-hw-vote-needed = <0x01 0x01 0x01 0x01 0x01 0x01 0x01>;
				qcom,msm-mi2s-master = <0x01 0x01 0x01 0x01 0x01 0x01 0x01>;
				qcom,model = "kera-cdp-snd-card";
			};

			pri_mi2s_pinctrl {
				phandle = <0x3e>;
				#gpio-cells = <0x00>;
				pinctrl-1 = <0xffffffff 0xffffffff 0xffffffff>;
				pinctrl-0 = <0xffffffff 0xffffffff 0xffffffff>;
				pinctrl-names = "aud_active", "aud_sleep";
				compatible = "qcom,msm-cdc-pinctrl";
				status = "ok";
			};

			quat_mi2s_pinctrl {
				phandle = <0x3f>;
				#gpio-cells = <0x00>;
				qcom,tlmm-pins = <0x8a 0x8f>;
				qcom,lpi-gpios;
				pinctrl-1 = <0x4a 0x4b 0x4c 0x4d 0x4e 0x4f>;
				pinctrl-0 = <0x44 0x45 0x46 0x47 0x48 0x49>;
				pinctrl-names = "aud_active", "aud_sleep";
				compatible = "qcom,msm-cdc-pinctrl";
				status = "disabled";
			};

			quin_mi2s_pinctrl {
				phandle = <0x40>;
				#gpio-cells = <0x00>;
				qcom,tlmm-pins = <0x90 0x93>;
				qcom,lpi-gpios;
				pinctrl-1 = <0x54 0x55 0x56 0x57>;
				pinctrl-0 = <0x50 0x51 0x52 0x53>;
				pinctrl-names = "aud_active", "aud_sleep";
				compatible = "qcom,msm-cdc-pinctrl";
				status = "disabled";
			};

			sen_mi2s_pinctrl {
				phandle = <0x41>;
				#gpio-cells = <0x00>;
				qcom,tlmm-pins = <0x94 0x97>;
				qcom,lpi-gpios;
				pinctrl-1 = <0x5c 0x5d 0x5e 0x5f>;
				pinctrl-0 = <0x58 0x59 0x5a 0x5b>;
				pinctrl-names = "aud_active", "aud_sleep";
				compatible = "qcom,msm-cdc-pinctrl";
				status = "disabled";
			};

			sep_mi2s_pinctrl {
				phandle = <0x42>;
				#gpio-cells = <0x00>;
				qcom,tlmm-pins = <0x99 0x9c>;
				qcom,lpi-gpios;
				pinctrl-1 = <0x64 0x65 0x66 0x67>;
				pinctrl-0 = <0x60 0x61 0x62 0x63>;
				pinctrl-names = "aud_active", "aud_sleep";
				compatible = "qcom,msm-cdc-pinctrl";
				status = "disabled";
			};

			wsa_swr_clk_data_pinctrl {
				phandle = <0x2d>;
				#gpio-cells = <0x00>;
				qcom,tlmm-pins = <0x95>;
				qcom,lpi-gpios;
				pinctrl-1 = <0x6a 0x6b>;
				pinctrl-0 = <0x68 0x69>;
				pinctrl-names = "aud_active", "aud_sleep";
				compatible = "qcom,msm-cdc-pinctrl";
				status = "disabled";
			};

			rx_swr_clk_data_pinctrl {
				phandle = <0x2b>;
				#gpio-cells = <0x00>;
				qcom,tlmm-pins = <0x8e>;
				qcom,lpi-gpios;
				pinctrl-1 = <0x6f 0x70 0x71>;
				pinctrl-0 = <0x6c 0x6d 0x6e>;
				pinctrl-names = "aud_active", "aud_sleep";
				compatible = "qcom,msm-cdc-pinctrl";
			};

			tx_swr_clk_data_pinctrl {
				phandle = <0x2a>;
				#gpio-cells = <0x00>;
				qcom,tlmm-pins = <0x8b>;
				qcom,chip-wakeup-default-val = <0x01>;
				qcom,chip-wakeup-maskbit = <0x07>;
				qcom,chip-wakeup-reg = <0xf18b008>;
				qcom,lpi-gpios;
				pinctrl-1 = <0x76 0x77 0x78 0x79>;
				pinctrl-0 = <0x72 0x73 0x74 0x75>;
				pinctrl-names = "aud_active", "aud_sleep";
				compatible = "qcom,msm-cdc-pinctrl";
			};

			cdc_dmic01_pinctrl {
				phandle = <0x3c>;
				#gpio-cells = <0x00>;
				qcom,tlmm-pins = <0x90 0x91>;
				qcom,lpi-gpios;
				pinctrl-1 = <0x7c 0x7d>;
				pinctrl-0 = <0x7a 0x7b>;
				pinctrl-names = "aud_active", "aud_sleep";
				compatible = "qcom,msm-cdc-pinctrl";
				status = "disabled";
			};

			cdc_dmic23_pinctrl {
				phandle = <0x3d>;
				#gpio-cells = <0x00>;
				qcom,tlmm-pins = <0x92 0x93>;
				qcom,lpi-gpios;
				pinctrl-1 = <0x80 0x81>;
				pinctrl-0 = <0x7e 0x7f>;
				pinctrl-names = "aud_active", "aud_sleep";
				compatible = "qcom,msm-cdc-pinctrl";
				status = "disabled";
			};

			cdc_dmic45_pinctrl {
				phandle = <0xe1>;
				#gpio-cells = <0x00>;
				qcom,tlmm-pins = <0x96 0x97>;
				qcom,lpi-gpios;
				pinctrl-1 = <0x84 0x85>;
				pinctrl-0 = <0x82 0x83>;
				pinctrl-names = "aud_active", "aud_sleep";
				compatible = "qcom,msm-cdc-pinctrl";
				status = "disabled";
			};

			cdc_dmic67_pinctrl {
				phandle = <0x43>;
				#gpio-cells = <0x00>;
				qcom,tlmm-pins = <0x9b 0x9c>;
				qcom,lpi-gpios;
				pinctrl-1 = <0x88 0x89>;
				pinctrl-0 = <0x86 0x87>;
				pinctrl-names = "aud_active", "aud_sleep";
				compatible = "qcom,msm-cdc-pinctrl";
				status = "okay";
			};

			bt_swr_clk_data_pinctrl {
				phandle = <0x38>;
				#gpio-cells = <0x00>;
				qcom,lpi-gpios;
				pinctrl-1 = <0x8c 0x8d>;
				pinctrl-0 = <0x8a 0x8b>;
				pinctrl-names = "aud_active", "aud_sleep";
				compatible = "qcom,msm-cdc-pinctrl";
			};
		};
	};

	fragment@25 {
		target = <0xffffffff>;

		__overlay__ {

			wsa_spkr_en1_pinctrl {
				phandle = <0x2e>;
				qcom,lpi-gpios;
				pinctrl-1 = <0xffffffff>;
				pinctrl-0 = <0xffffffff>;
				pinctrl-names = "aud_active", "aud_sleep";
				compatible = "qcom,msm-cdc-pinctrl";
				status = "disabled";
			};

			wsa_spkr_en2_pinctrl {
				phandle = <0x30>;
				qcom,lpi-gpios;
				pinctrl-1 = <0xffffffff>;
				pinctrl-0 = <0xffffffff>;
				pinctrl-names = "aud_active", "aud_sleep";
				compatible = "qcom,msm-cdc-pinctrl";
				status = "disabled";
			};

			msm_cdc_pinctrl@32 {
				phandle = <0x31>;
				pinctrl-1 = <0xffffffff>;
				pinctrl-0 = <0xffffffff>;
				pinctrl-names = "aud_active", "aud_sleep";
				compatible = "qcom,msm-cdc-pinctrl";
			};

			va_core_clk {
				phandle = <0x29>;
				#clock-cells = <0x01>;
				qcom,codec-lpass-clk-id = <0x307>;
				qcom,codec-lpass-ext-clk-freq = <0x124f800>;
				qcom,codec-ext-clk-src = <0x02>;
				compatible = "qcom,audio-ref-clk";
			};

			wsa_core_clk {
				phandle = <0xe2>;
				#clock-cells = <0x01>;
				qcom,codec-lpass-clk-id = <0x309>;
				qcom,codec-lpass-ext-clk-freq = <0x124f800>;
				qcom,codec-ext-clk-src = <0x03>;
				compatible = "qcom,audio-ref-clk";
				status = "disabled";
			};

			rx_core_clk {
				phandle = <0x27>;
				#clock-cells = <0x01>;
				qcom,codec-lpass-clk-id = <0x30e>;
				qcom,codec-lpass-ext-clk-freq = <0x1588800>;
				qcom,codec-ext-clk-src = <0x05>;
				compatible = "qcom,audio-ref-clk";
			};

			rx_core_tx_clk {
				phandle = <0x28>;
				#clock-cells = <0x01>;
				qcom,codec-lpass-clk-id = <0x312>;
				qcom,codec-lpass-ext-clk-freq = <0x124f800>;
				qcom,codec-ext-clk-src = <0x0d>;
				compatible = "qcom,audio-ref-clk";
			};

			tx_core_clk {
				phandle = <0x26>;
				#clock-cells = <0x01>;
				qcom,codec-lpass-clk-id = <0x30c>;
				qcom,codec-lpass-ext-clk-freq = <0x124f800>;
				qcom,codec-ext-clk-src = <0x07>;
				compatible = "qcom,audio-ref-clk";
			};

			wsa_core_tx_clk {
				phandle = <0xe3>;
				#clock-cells = <0x01>;
				qcom,codec-lpass-clk-id = <0x314>;
				qcom,codec-lpass-ext-clk-freq = <0x124f800>;
				qcom,codec-ext-clk-src = <0x0e>;
				compatible = "qcom,audio-ref-clk";
				status = "disabled";
			};

			rx_mclk2_2x_clk {
				phandle = <0x2c>;
				#clock-cells = <0x01>;
				qcom,codec-lpass-clk-id = <0x318>;
				qcom,codec-lpass-ext-clk-freq = <0x124f800>;
				qcom,codec-ext-clk-src = <0x10>;
				compatible = "qcom,audio-ref-clk";
			};

			bt_swr_mclk_clk {
				phandle = <0x36>;
				#clock-cells = <0x01>;
				qcom,codec-lpass-clk-id = <0x31a>;
				qcom,codec-lpass-ext-clk-freq = <0x1770000>;
				qcom,codec-ext-clk-src = <0x12>;
				compatible = "qcom,audio-ref-clk";
			};

			bt_swr_mclk_clk_2x {
				phandle = <0x37>;
				#clock-cells = <0x01>;
				qcom,codec-lpass-clk-id = <0x31b>;
				qcom,codec-lpass-ext-clk-freq = <0x1770000>;
				qcom,codec-ext-clk-src = <0x13>;
				compatible = "qcom,audio-ref-clk";
			};
		};
	};

	fragment@26 {
		target = <0xffffffff>;

		__overlay__ {
			status = "ok";
		};
	};

	fragment@27 {
		target = <0xffffffff>;

		__overlay__ {
			status = "disabled";
		};
	};

	fragment@28 {
		target = <0xffffffff>;

		__overlay__ {

			bt_en {
				phandle = <0xe4>;
				power-source = <0x01>;
				bias-disable;
				output-enable;
				input-disable;
				function = "normal";
				pins = "gpio4";
			};
		};
	};

	fragment@29 {
		target = <0xffffffff>;

		__overlay__ {

			cnss_wlan_sw_ctrl {
				phandle = <0xe5>;

				mux {
					function = "wcn_sw_ctrl";
					pins = "gpio81";
				};
			};
		};
	};

	fragment@30 {
		target = <0xffffffff>;

		__overlay__ {

			bt_wcn6750 {
				phandle = <0xe6>;
				qcom,bt-vdd-ipa-2p2-config = <0x2191c0 0x2932e0 0x00 0x01>;
				qcom,bt-vdd-rfa2-config = <0x132a40 0x1febe0 0x00 0x01>;
				qcom,bt-vdd-rfa1-config = <0x1c5200 0x1f3060 0x00 0x01>;
				qcom,bt-vdd-rfa-0p8-config = <0xe09c0 0x29bf80 0x00 0x01>;
				qcom,bt-vdd-rfacmn-config = <0xe09c0 0x29bf80 0x00 0x01>;
				qcom,bt-vdd-dig-config = <0xe09c0 0x29bf80 0x00 0x01>;
				qcom,bt-vdd-aon-config = <0xe09c0 0x29bf80 0x00 0x01>;
				qcom,bt-vdd-io-config = <0x18b820 0x1b7740 0x00 0x01>;
				qcom,bt-vdd-ipa-2p2-supply = <0xffffffff>;
				qcom,bt-vdd-rfa2-supply = <0xffffffff>;
				qcom,bt-vdd-rfa1-supply = <0xffffffff>;
				qcom,bt-vdd-rfa-0p8-supply = <0xffffffff>;
				qcom,bt-vdd-rfacmn-supply = <0xffffffff>;
				qcom,bt-vdd-dig-supply = <0xffffffff>;
				qcom,bt-vdd-aon-supply = <0xffffffff>;
				qcom,bt-vdd-io-supply = <0xffffffff>;
				qcom,bt-reset-gpio = <0xffffffff 0x04 0x00>;
				qcom,bt-sw-ctrl-gpio = <0xffffffff 0x51 0x00>;
				qcom,wl-reset-gpio = <0xffffffff 0x23 0x00>;
				pinctrl-1 = <0xe5>;
				pinctrl-0 = <0xe4>;
				pinctrl-names = "bt_en", "sw_ctrl";
				compatible = "qcom,wcn6750-bt";
			};
		};
	};

	fragment@31 {
		target = <0xffffffff>;

		__overlay__ {
			status = "ok";

			ngd@1 {
				#size-cells = <0x01>;
				#address-cells = <0x01>;
				reg = <0x01>;

				btfmslim-driver {
					phandle = <0xe7>;
					qcom,btslimrx-channels = <0x9d 0x9e>;
					qcom,btslimtx-channels = <0x9f 0xa0>;
					qcom,btslim-address = <0x00>;
					reg = <0x01 0x00>;
					compatible = "slim217,221";
				};
			};
		};
	};

	fragment@32 {
		target = <0xffffffff>;

		__overlay__ {
			status = "ok";
		};
	};

	fragment@33 {
		target = <0xffffffff>;

		__overlay__ {
			status = "ok";

			nq@64 {
				rtc6226,vio-supply-voltage = <0x1b7740 0x1b7740>;
				vio-supply = <0xffffffff>;
				rtc6226,vdd-load = <0x3a98>;
				rtc6226,vdd-supply-voltage = <0x2ab980 0x2ab980>;
				vdd-supply = <0xffffffff>;
				reg = <0x64>;
				compatible = "rtc6226";
			};
		};
	};

	fragment@34 {
		target = <0xffffffff>;

		__overlay__ {

			icnss_sw_ctrl {
				phandle = <0xe8>;

				mux {
					function = "wcn_sw_ctrl";
					pins = "gpio81";
				};
			};
		};
	};

	fragment@35 {
		target = <0xffffffff>;

		__overlay__ {

			qcom,smp2p-wpss {

				qcom,smp2p-wlan-1-in {
					phandle = <0xec>;
					#interrupt-cells = <0x02>;
					interrupt-controller;
					qcom,entry-name = "wlan";
				};

				qcom,smp2p-wlan-1-out {
					phandle = <0xe9>;
					#qcom,smem-state-cells = <0x01>;
					qcom,entry-name = "wlan";
				};

				qcom,smp2p-wlan-2-in {
					phandle = <0xed>;
					#interrupt-cells = <0x02>;
					interrupt-controller;
					qcom,entry-name = "wlan_soc_wake";
				};

				qcom,smp2p-wlan-2-out {
					phandle = <0xea>;
					#qcom,smem-state-cells = <0x01>;
					qcom,entry-name = "wlan_soc_wake";
				};

				qcom,smp2p-wlan-3-out {
					phandle = <0xeb>;
					#qcom,smem-state-cells = <0x01>;
					qcom,entry-name = "wlan_ep_power_save";
				};
			};

			qcom,wcn6750 {
				phandle = <0xee>;
				qcom,vreg_ol_cpr = "s3b";
				qcom,qmp = <0xffffffff>;
				qcom,smem-state-names = "wlan-smp2p-out", "wlan-soc-wake-smp2p-out", "wlan-ep-powersave-smp2p-out";
				qcom,smem-states = <0xe9 0x00 0xea 0x00 0xeb 0x00>;
				qcom,vdd-1.8-io-config = <0x1b7740 0x1b7740 0x00 0x00 0x00>;
				vdd-1.8-io-supply = <0xffffffff>;
				qcom,vdd-1.3-rfa-config = <0x132a40 0x157c00 0x00 0x00 0x00>;
				vdd-1.3-rfa-supply = <0xffffffff>;
				qcom,vdd-1.8-xo-config = <0x1c5200 0x1f20c0 0x00 0x00 0x00>;
				vdd-1.8-xo-supply = <0xffffffff>;
				qcom,vdd-cx-mx-config = <0xe09c0 0xfde80 0x00 0x00 0x00>;
				vdd-cx-mx-supply = <0xffffffff>;
				qcom,wlan-msa-fixed-region = <0xffffffff>;
				wcn-hw-version = "qca6750";
				tsens = "sys-therm-3";
				qcom,wlan;
				qcom,fw-prefix;
				pin-ctrl-support;
				dma-coherent;
				qcom,iommu-geometry = <0xb0000000 0x10010000>;
				qcom,iommu-dma-addr-pool = <0xb0000000 0x10000000>;
				qcom,iommu-faults = "stall-disable", "HUPCF", "non-fatal";
				qcom,iommu-dma = "fastmap";
				interrupts = <0x00 0x300 0x01 0x00 0x301 0x01 0x00 0x302 0x01 0x00 0x303 0x01 0x00 0x304 0x01 0x00 0x305 0x01 0x00 0x306 0x01 0x00 0x307 0x01 0x00 0x308 0x01 0x00 0x309 0x01 0x00 0x30a 0x01 0x00 0x30b 0x01 0x00 0x30c 0x01 0x00 0x30d 0x01 0x00 0x30e 0x01 0x00 0x30f 0x01 0x00 0x310 0x01 0x00 0x311 0x01 0x00 0x312 0x01 0x00 0x313 0x01 0x00 0x314 0x01 0x00 0x315 0x01 0x00 0x316 0x01 0x00 0x317 0x01 0x00 0x318 0x01 0x00 0x319 0x01 0x00 0x31a 0x01 0x00 0x31b 0x01 0x00 0x31c 0x01 0x00 0x31d 0x01 0x00 0x31e 0x01 0x00 0x31f 0x01>;
				pinctrl-0 = <0xe8>;
				pinctrl-names = "sw_ctrl";
				mpm_wake_set_gpios = <0x51>;
				sw-ctrl-gpio = <0x51>;
				dev-sol-gpio = <0x20>;
				host-sol-gpio = <0x21>;
				wlan-en-gpio = <0x23>;
				iommus = <0xffffffff 0x1480 0x01>;
				qcom,rproc-handle = <0xffffffff>;
				reg-names = "msi_addr", "smmu_iova_ipa";
				reg = <0x17110040 0x00 0xc0000000 0x10000>;
				compatible = "qcom,wcn6750";

				qcom,icnss_cdev1 {
					phandle = <0xef>;
					#cooling-cells = <0x02>;
				};

				qcom,icnss_cdev2 {
					phandle = <0xf0>;
					#cooling-cells = <0x02>;
				};

				qcom,smp2p_map_wlan_1_in {
					interrupt-names = "qcom,smp2p-force-fatal-error", "qcom,smp2p-early-crash-ind";
					interrupts-extended = <0xec 0x00 0x00 0xec 0x01 0x00>;
				};

				qcom,smp2p_map_wlan_2_in {
					interrupt-names = "qcom,smp2p-soc-wake-ack";
					interrupts-extended = <0xed 0x00 0x00>;
				};
			};
		};
	};
};
